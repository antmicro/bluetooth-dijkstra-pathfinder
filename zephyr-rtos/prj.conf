## CMakeLists.txt
```
cmake_minimum_required(VERSION 3.20.0)

# add variable to store build option 
SET(MAX_MESH_SIZE "9" CACHE STRING "Define max mesh size")

# add variable to store max allowed ttl
SET(MAX_TTL "9" CACHE STRING "Define max time to live for a packet.")

# add variable to store topology config file path passed during west build
SET(TOPOLOGY_CONFIG_PATH "" CACHE STRING 
    "Pass path to topology .json file to c file generator")

# add a custom build target 
add_custom_target(generator ALL)

# attach command to it
add_custom_command(
  TARGET generator
  COMMAND python3 ${CMAKE_CURRENT_SOURCE_DIR}/../scripts/generator.py ${TOPOLOGY_CONFIG_PATH} 
  DEPENDS ${CMAKE_CURRENT_SOURCE_DIR}/../${TOPOLOGY_CONFIG_PATH}
  BYPRODUCTS ${CMAKE_CURRENT_SOURCE_DIR}/src/generated-src/graph_api_generated.c
  BYPRODUCTS ${CMAKE_CURRENT_SOURCE_DIR}/include/graph_api_generated.h
  VERBATIM)

set(BOARD nrf52840dk_nrf52840)

find_package(Zephyr REQUIRED HINTS $ENV{ZEPHYR_BASE})
project(my_zephyr_app)

target_include_directories(app PUBLIC ${include})

# build with max mesh size and max ttl specified as preprocessor #define
target_compile_definitions(app PUBLIC MAX_MESH_SIZE=${MAX_MESH_SIZE})
target_compile_definitions(app PUBLIC MAX_TTL=${MAX_TTL})

# add dependency between app target and generator target 
add_dependencies(app generator)

target_sources(app PRIVATE 
    src/main.c
    src/graph.c 
    src/generated-src/graph_api_generated.c
    src/dijkstra.c
    src/bluetooth_ble.c)
```

## prj.conf
```kconfig
# dongle
#CONFIG_USB_DEVICE_STACK=y
#CONFIG_USB_DEVICE_PRODUCT="Zephyr USB console sample"

#CONFIG_SERIAL=y
#CONFIG_CONSOLE=y
#CONFIG_UART_CONSOLE=y
#CONFIG_UART_LINE_CTRL=y

# renode
#CONFIG_SERIAL=y
#CONFIG_UART_INTERRUPT_DRIVEN=y
#CONFIG_ZTEST=y
#CONFIG_NATIVE_UART_0_ON_STDINOUT=y
CONFIG_HEAP_MEM_POOL_SIZE=1024

# Combined build for BLE stack
# Minimal recommended BLE config from Zephyr docs 
CONFIG_BT=y
CONFIG_BT_HCI=y
#CONFIG_BT_HCI=y
#CONFIG_BT_CTRL=y
#CONFIG_BT_LL_SW_SPLIT=y

# Additional researched in samples
#CONFIG_BT_EXT_ADV=y # extended advertisement possibilities multiple sets
#CONFIG_BT_PER_ADV=y # periodic advertisement

# Configure as broadcaster and observer 
CONFIG_BT_BROADCASTER=y
CONFIG_BT_OBSERVER=y

#CONFIG_HWINFO=y

#CONFIG_BT_CTLR_ADV_EXT=y
#CONFIG_BT_SCAN_WITH_IDENTITY=y # enable to use directed messages 
#CONFIG_BT_PRIVACY=n

#CONFIG_BT_EXT_ADV_MAX_ADV_SET=2

CONFIG_TIMING_FUNCTIONS=y

#CONFIG_EVENTS=y

CONFIG_LOG=y
#CONFIG_BT_DEBUG_LOG=y
#CONFIG_BT_DEBUG_HCI_DRIVER=y
#CONFIG_BT_DEBUG_HCI_CORE=y
#CONFIG_LOG_BUFFER_SIZE=20000

#CONFIG_THREAD_ANALYZER=y
#CONFIG_THREAD_ANALYZER_USE_PRINTK=y
#CONFIG_THREAD_ANALYZER_AUTO=y
#CONFIG_THREAD_NAME=y
#CONFIG_BT_CTLR_TX_BUFFER_SIZE=251
#CONFIG_BT_RX_BUF_LEN=258
#CONFIG_BT_CTLR_DATA_LENGTH_MAX=251
```

## src/main.c
```c
#include <zephyr.h>
// PZIE: remove commented lines
//#include <device.h>
//#include <devicetree.h>
//#include <drivers/gpio.h>
#include <sys/printk.h>
//#include <usb/usb_device.h>
#include <drivers/uart.h>
//#include <string.h>
#include <drivers/hwinfo.h>
#include <device.h>

#include "../include/graph.h"
#include "../include/dijkstra.h"
#include "../include/bluetooth_ble.h"

/* 1000 msec = 1 sec */ // PZIE: Really? :P
#define SLEEP_TIME_MS   1000

/* Threads data */
#define SEND_DATA_PACKET_THREAD_S_SIZE 1024
#define SEND_DATA_PACKET_THREAD_PRIO 2
K_THREAD_STACK_DEFINE(send_data_packet_thread_stack, 
        SEND_DATA_PACKET_THREAD_S_SIZE);

#define SEND_ACK_THREAD_S_SIZE 1024
#define SEND_ACK_THREAD_PRIO 1 
K_THREAD_STACK_DEFINE(send_ack_thread_stack, 
        SEND_ACK_THREAD_S_SIZE);

#define SEND_RT_THREAD_S_SIZE 1024
#define SEND_RT_THREAD_PRIO 6
K_THREAD_STACK_DEFINE(send_rt_thread_stack,
        SEND_RT_THREAD_S_SIZE);

K_THREAD_DEFINE(send_ack_thread, SEND_ACK_THREAD_S_SIZE,
ble_send_ack_thread_entry, NULL, NULL, NULL,
SEND_ACK_THREAD_PRIO, 0, 0);

k_tid_t send_data_packet_thread_id;
struct node_t graph[MAX_MESH_SIZE];

void main(void)
{
    /* Graph Initialization */
    uint8_t graph_init_error_code = graph_init(graph);
    if(graph_init_error_code){
        printk("Graph initialization failed! \n");
        return; // PZIE: what happens on return? Shouldn't there be some assert?
    }
    
    /* Bluetooth setup */ 
    int err = bt_enable(NULL);
    if(err){
        printk("BLE Initialization failed!\n"); //PZIE: And move forward?
    }

    err = identify_self_in_graph(graph);
    if(err){
        printk("BLE self identification failed!\n");
    }
    
    struct bt_le_scan_param scan_params;
    ble_scan_setup(&scan_params);
    
    printk("BUILT FOR %d NUMBER OF NODES\n", MAX_MESH_SIZE); //PZIE: Why caps? What was build for N nodes?

    /* Create Bluetooth LE threads */
    struct k_thread send_data_packet_thread;
    send_data_packet_thread_id = k_thread_create(&send_data_packet_thread,
            send_data_packet_thread_stack,
            K_THREAD_STACK_SIZEOF(send_data_packet_thread_stack),
            ble_send_data_packet_thread_entry,
            &graph, NULL, NULL,
            SEND_DATA_PACKET_THREAD_PRIO, 0, K_NO_WAIT);
    k_thread_name_set(&send_data_packet_thread, "send_data_packet_thread");

    struct k_thread send_rt_thread;
    k_tid_t send_rt_thread_id = k_thread_create(&send_rt_thread,
            send_rt_thread_stack,
            K_THREAD_STACK_SIZEOF(send_rt_thread_stack),
            ble_send_rt_thread_entry,
            &graph, NULL, NULL,
            SEND_RT_THREAD_PRIO, 0, K_NO_WAIT);
    
    // Start counter that will add self to the routing table record propagation thread
    k_timer_start(&add_self_to_rtr_queue_timer, K_MSEC(2000), K_MSEC(60000)); // PZIE: use defines, especially to name these params

    
    /* Bluetooth scanning */
    err  = bt_le_scan_start(&scan_params, NULL); 
    if(err){
        printk("BLE scan error code: %d\n", err);
    }

    /* Debug */
    while (1) {
        const struct device *dev;
        dev = DEVICE_DT_GET(DT_CHOSEN(zephyr_console));
        
        //thread_analyzer_print();
	    	
        k_msleep(SLEEP_TIME_MS);
	}
}
```

## include/bluetooth_ble.h
```c
#ifndef BLUETOOTH_BLE_H
#define BLUETOOTH_BLE_H

#include <sys/printk.h>
#include <bluetooth/hci.h>
#include <bluetooth/bluetooth.h>
#include <bluetooth/conn.h>
#include <bluetooth/rfcomm.h>
#include <bluetooth/sdp.h>
#include <bluetooth/iso.h>
#include "graph.h"

// Header indexes definitions
#define SENDER_ID_IDX 0
#define MSG_TYPE_IDX 1
#define DST_ADDR_IDX 2
#define RCV_ADDR_IDX 3
#define TIME_STAMP_MSB_IDX 4
#define TIME_STAMP_LSB_IDX 5
#define TTL_IDX 6
#define HEADER_SIZE 7

#define MSG_TYPE_DATA 0x1
#define MSG_TYPE_ROUTING_TAB 0x2
#define MSG_TYPE_ACK 0x3

#define BROADCAST_ADDR 0x7F // 127

#define BLE_DATA_MSG_LEN 8
#define BLE_RTR_MSG_LEN 24
#define BLE_ACK_MSG_LEN 8
#define BLE_LONGEST_MSG_LEN 24

#define RECEIVEQ_PUT_TIMEOUT_MS 10

#define CB_POP_TIME_MS 900

#define ACK_ADV_TIME_MS 200
#define DATA_ADV_TIME_MS 500

// Global variable with sender thread id to wake it up
extern k_tid_t send_data_packet_thread_id;

// Global variable for starting the add_self_to_rtr_queue_timer
extern struct k_timer add_self_to_rtr_queue_timer; 

typedef struct {
    uint8_t node_id;
    uint16_t time_stamp;
    uint8_t msg_type;
}__attribute__((aligned(4))) ble_sender_info;


struct ble_packet_info {
    uint8_t ble_data[BLE_DATA_MSG_LEN];
    uint8_t resend_counter;
};


typedef struct {
    ble_sender_info *buff_start;
    ble_sender_info *buff_end;
    size_t capacity;
    size_t count;
    ble_sender_info *head;
    ble_sender_info *tail;
} rcv_pkts_cb;

void ble_scan_setup(struct bt_le_scan_param *scan_params);
void ble_send_data_packet_thread_entry(struct node_t *graph);
void ble_send_ack_thread_entry();
void ble_send_rt_thread_entry(struct node_t *graph);


// callbacks 
void bt_msg_received_cb(
        const struct bt_le_scan_recv_info *info,
		      struct net_buf_simple *buf);

void ble_scanned(
        struct bt_le_ext_adv *adv,
        struct bt_le_ext_adv_scanned_info *info);

void ble_sent(struct bt_le_ext_adv *adv, 
        struct bt_le_ext_adv_sent_info *info);

/* Utility functions */
bool ble_is_receiver(uint8_t data[],uint8_t common_self_mesh_id);
uint16_t ble_add_packet_timestamp(uint8_t data[]);
uint16_t ble_get_packet_timestamp(uint8_t data[]);

// Timer callbacks
void add_self_to_rtr_queue(struct k_timer *timer);

// Circular buffer 
// Static initialization
#define RCV_PKTS_DEFINE(cb_name, cb_capacity) \
    ble_sender_info arr[cb_capacity]; \
    rcv_pkts_cb cb_name = {  \
        .buff_start = arr, \
        .buff_end = arr + cb_capacity,  \
        .capacity = cb_capacity, \
        .count = 0, \
        .head = arr, \
        .tail = arr\
    }
// head and tail set to arr_ptr are overkill but its done for the buff

void rcv_pkts_cb_push(rcv_pkts_cb *cb, ble_sender_info *item);
void rcv_pkts_cb_pop(rcv_pkts_cb *cb);
bool rcv_pkts_cb_is_in_cb(rcv_pkts_cb *cb, ble_sender_info *item);

bool ble_wait_for_ack(int32_t timeout_ms);

void print_msgq_num_used(struct k_msgq *mq, char name[]);

#define MSG_Q_NAME(mq) (#mq)
#endif
```

## include/dijkstra.h
```c
#ifndef DIJKSTRA_H
#define DIJKSTRA_H

#include "../include/graph.h"

#define DEBUG 

struct node_container{
    sys_snode_t next_container_node_ptr;
    struct node_t * node;
};

// global variable updated with path after dijkstra algorithm  
extern uint16_t * path; // TODO: make init function

// PZIE: These could, actually, use a language check. But it's nice we have comments!
// PZIE: what about these todos?
/**
 * @brief Perform shortest path algorithm on graph, between start and dst adrresses.
 * Function locks graph mutex, reads and modifies graph members. 
 * TODO: in docs sum up all things that this  function modifies according to other funcs
 * TODO: make other functions static 
 * TODO: add path inverting function
 * TODO: add path returning
 * TODO: add graph resetting function, called at the beginning of di 
 * @param start_addr address of starting node. 
 * @param dst_addr address of destination node.
 *
 * @return 0 on succes -1 on failure.
 */
int dijkstra_shortest_path(
        struct node_t *graph,
        uint8_t graph_size,
        uint8_t start_addr,
        uint8_t dst_addr);

/**
 * @brief Get the slist container with node that has the smallest tentative_distance 
 * for algorithm purposes. If function fails buffer will be NULL and it will return
 * 1.
 *
 * @param lst pointer to a unvisited list, from which to pick node with smallest td.
 * @param container_buffer buffer with slist container that stores node with smallest td. 
 * if list is empty, so be careful dereferencing it.
 *
 * @return 0 if node was found and 1 if list is empty.
 */
uint8_t get_smallest_td_node(sys_slist_t * lst, struct node_container ** container_buffer);


// get to a node, iterate thorugh its neighbours, check if path thorugh current node is smaller
// than current tentative_distance of a neighbour


/**
 * @brief Checks a node's neighbours if their tentative_distance is smaller through
 * current node, if so it is modified and node is marked as visited.
 *
 * @param node_addr
 */
void recalculate_td_for_neighbours(uint8_t node_addr, struct node_t *graph); 

// need initialized memory heap
uint16_t * trace_back(
        struct node_t *graph,
        uint8_t start_addr, 
        uint8_t dst_addr, 
        uint8_t * paths_len);


/**
 * @brief Create a list of nodes for search, excluding starting node. List is single
 * linked list data structure, as it will be oftnely iterated through and after
 * each iteration one of elements (with lowest td) will be processed and removed.
 * Members of a list - node_containers are malloced and caller is responsible for 
 * freeing!
 *
 * @param lst Pointer to list.
 * @param start_addr address of a node that is starting node.
 *
 * @return 
 */
uint8_t create_unvisited_slist(struct node_t *graph, 
        uint8_t graph_size, sys_slist_t * lst);


/**
 * @brief Free unvisited list from remaining members.
 *
 * @param lst unvisited list.
 */
void free_slist(sys_slist_t * lst);


/**
 * @brief Removes a member from a list and frees a memory k_malloced for node container.
 *
 * @param lst list to remove a member.
 * @param node_to_remove member to remove.
 */
void remove_unvisited_slist_member(sys_slist_t * lst, struct node_container ** node_to_remove);

#ifdef DEBUG 

/**
 * @brief Print addresses of nodes contained in the list.
 *
 * @param lst list of unvisited nodes.
 */
void print_slist(sys_slist_t * lst);

#endif
#endif 
```

## include/graph.h
```c
#ifndef GRAPH_H 
#define GRAPH_H

#include <stdint.h>
#include <stdbool.h>
#include <kernel.h> // for k_k_malloc
#include <bluetooth/addr.h>

#define INF 65535


struct node_t{
    struct k_mutex node_mutex;
    uint8_t addr;
    char addr_bt_le[18];
    bool reserved; 

    bool visited;

    uint16_t tentative_distance;

    uint8_t paths_size;
    struct path_t * paths;
};


extern uint8_t common_self_mesh_id; 
extern struct node_t graph[MAX_MESH_SIZE];

uint8_t graph_init(struct node_t *graph);

// Dijkstra's utility 
void reset_td_visited(struct node_t *graph);

// Setters and getters respecting the mutex access
int node_t_visited_set(struct node_t *node, bool new_val); 
int node_t_visited_get(struct node_t *node, bool *ret_val); 
int node_t_tentative_distance_set(struct node_t *node, uint16_t new_val);
int node_t_tentative_distance_get(struct node_t *node, uint16_t *ret_val);
int path_t_cost_set(struct path_t *path, uint16_t new_val);
int path_t_cost_get(struct path_t *path, uint16_t *ret_val);

void graph_set_cost(struct node_t *graph,
        uint8_t mesh_id_1, uint8_t mesh_id_2, uint8_t new_cost);
void node_update_missed_transmissions(struct node_t *node, 
        bool transmission_success);
uint16_t calc_distance_from_missed_transmissions(uint64_t missed_transmissions);

void node_to_byte_array(struct node_t *node, uint8_t buffer[], uint8_t buffer_size);
size_t node_get_size_in_bytes(struct node_t *node);
void load_rtr(struct node_t graph[], uint8_t buff[], uint8_t size);
void load_node_info(struct node_t *node, uint8_t neigh_addr, uint8_t cost);
void print_graph(struct node_t graph[]);

uint8_t identify_self_in_graph(struct node_t *graph);
uint8_t get_mesh_id_by_ble_addr(struct node_t *graph, char *ble_addr, uint8_t *mesh_id);

#endif
```

## src/bluetooth_ble.c
```c
#include <zephyr.h>
#include <kernel/thread_stack.h>
#include "kernel.h"
#include <timing/timing.h>
#include <assert.h>
#include "../include/dijkstra.h"
#include "../include/bluetooth_ble.h"
#include "../include/graph_api_generated.h"

/* Queues for message passing and processing */
// Holds single instance of info about awaited ack message
K_MSGQ_DEFINE(awaiting_ack,
        sizeof(ble_sender_info), 1, 4);

// Queues for threads sending messages
K_MSGQ_DEFINE(ack_receivers_q,
        sizeof(ble_sender_info), 10, 4);
K_MSGQ_DEFINE(data_packets_to_send_q,
        sizeof(struct ble_packet_info), 10, 4);
K_MSGQ_DEFINE(rtr_packets_to_send_q,
        BLE_RTR_MSG_LEN, 10, 4);

// Queue for messages to send
K_MSGQ_DEFINE(ready_packets_to_send_q, 
        BLE_DATA_MSG_LEN, 10, 4); 

K_MUTEX_DEFINE(ble_send_mutex);
K_MUTEX_DEFINE(graph_mutex);

K_TIMER_DEFINE(add_self_to_rtr_queue_timer, add_self_to_rtr_queue, NULL);
//K_TIMER_DEFINE(pop_from_cb_timer, , NULL);

// Static initialization of circular buffer with recently received packets
RCV_PKTS_DEFINE(rcv_pkts_circular_buffer, 10);

/* Setup functions */
void ble_scan_setup(struct bt_le_scan_param *scan_params){
    *(scan_params) = (struct bt_le_scan_param){
		.type       = BT_LE_SCAN_TYPE_PASSIVE,  
		.options    = BT_LE_SCAN_OPT_NONE,//BT_LE_SCAN_OPT_CODED | 
		.interval   =  0x0060, 
		.window     =  0x0060 
	};
    
    // register a callback for packet reception
    static struct bt_le_scan_cb scan_callbacks = {
        .recv = bt_msg_received_cb,
    };
    bt_le_scan_cb_register(&scan_callbacks);
}


/* Thread entries */
void ble_send_data_packet_thread_entry(
        struct node_t *graph) {
    while(1){
        // Reserved memory for data and array for sending by BLE
        static struct ble_packet_info pkt_info;
        static struct bt_data ad_arr[] = {
            BT_DATA(0xAA, pkt_info.ble_data, BLE_DATA_MSG_LEN) 
        };

        // Get the packet content from the queue
        int err = k_msgq_get(&data_packets_to_send_q, &pkt_info, K_FOREVER);
        if(err){
            printk("ERROR: reading from queue: %d \n!\n", err);
            return;
        }
        
        /* Message preparation */
        // Calculate shortest path with Dijkstra algorithm
        uint8_t dst_mesh_id = pkt_info.ble_data[DST_ADDR_IDX];
        int next_node_mesh_id = dijkstra_shortest_path(graph, MAX_MESH_SIZE,
                common_self_mesh_id, dst_mesh_id);
        if(next_node_mesh_id < 0) {
            printk("ERROR: Dijkstra algorithm failed.\n");
            continue;
        }
        printk("Next hop: %d\n", next_node_mesh_id);
        
        // Header settings 
        pkt_info.ble_data[SENDER_ID_IDX] = common_self_mesh_id;
        pkt_info.ble_data[RCV_ADDR_IDX] = next_node_mesh_id;
        pkt_info.ble_data[TTL_IDX] = 0x01; // one jump allowed
        uint16_t timestamp = ble_add_packet_timestamp(pkt_info.ble_data);
        
        // Awaiting ack for this packet
        ble_sender_info ack_info = {
            .node_id = next_node_mesh_id,
            .time_stamp = timestamp,
            .msg_type = 0x0 // Unused here
        };

        printk("Awaiting for ack from node %d and with timestamp: %d\n",
                next_node_mesh_id, timestamp);
        err = k_msgq_put(&awaiting_ack, &ack_info, K_NO_WAIT);
        print_msgq_num_used(&awaiting_ack, MSG_Q_NAME(awaiting_ack));

        if(err){
            printk("ERROR: Failed to put into awaiting_ack q : %d.\n", err);
            return;
        }

        // Init adv params
        static struct bt_le_adv_param adv_tx_params = BT_LE_ADV_PARAM_INIT(
                BT_LE_ADV_OPT_USE_IDENTITY,
                BT_GAP_ADV_FAST_INT_MIN_1,
                BT_GAP_ADV_FAST_INT_MAX_1,
                NULL);
        
        // Lock the ble device
        k_mutex_lock(&ble_send_mutex, K_FOREVER);
        
        /* Sending a data message */
        err = bt_le_adv_start(&adv_tx_params, 
        ad_arr, ARRAY_SIZE(ad_arr), 
        NULL, 0);
        if(err) {
            printk("ERROR: could not start advertising : %d\n", err);
            return;
        }       
        printk("Started advertising a data packet.\n");

        // Wait for ack
        uint32_t time_left = k_msleep(DATA_ADV_TIME_MS);
        bool got_ack = time_left > 0;

        err = bt_le_adv_stop();
        if(err) {
            printk("ERROR: Failed to stop advertising %d.\n", err);
            return;
        }
        printk("Finished advertising a data packet.\n");
        
        // Release the device for ack thread to use 
        k_mutex_unlock(&ble_send_mutex);

        pkt_info.resend_counter++;
        printk("Resend counter: %d\n", pkt_info.resend_counter);
        
        // Remove flag indicating awaited ack
        ble_sender_info unused;
        err = k_msgq_get(&awaiting_ack, &unused, K_MSEC(50));
        
        // Cost recalculation and update
        struct path_t *used_path;
        for(uint8_t i = 0; i < graph[common_self_mesh_id].paths_size; i++){
            if(graph[common_self_mesh_id].paths[i].addr == next_node_mesh_id) {
                used_path = &graph[common_self_mesh_id].paths[i]; 
            }
        }
        uint16_t signal_str, phy_distance, missed_transmissions;
        path_t_signal_str_get(used_path, &signal_str);
        path_t_phy_distance_get(used_path, &phy_distance);
        path_t_missed_transmissions_get(used_path, &missed_transmissions);
        uint16_t new_cost = calc_cost(signal_str, phy_distance, missed_transmissions);
        graph_set_cost(graph, common_self_mesh_id, next_node_mesh_id, new_cost);
        printk("New calculated transition cost: %d\n", new_cost);

        // Put the message again into the queue and try to send it again
        if(!got_ack) {
            printk("##############################\n");
            printk("Did not receive ACK from node %d.\n", pkt_info.ble_data[RCV_ADDR_IDX]);
            printk("##############################\n");
            
            // Do not resend infinitely
            if(pkt_info.resend_counter < 3)k_msgq_put(
                    &data_packets_to_send_q, pkt_info.ble_data, K_NO_WAIT);
            print_msgq_num_used(&data_packets_to_send_q, MSG_Q_NAME(data_packets_to_send_q));
        }
        // Wait for the other node acknowledging to finish to so that not to 
        // flood it with new messages
        uint32_t data_adv_time = DATA_ADV_TIME_MS - time_left;
        if(data_adv_time < ACK_ADV_TIME_MS) {
            uint32_t wait_till_ack_time = ACK_ADV_TIME_MS - data_adv_time;
            printk("Waiting with sending another data packet for node %d to finish ACKing for %dms\n",
                    next_node_mesh_id, wait_till_ack_time);
            k_msleep(wait_till_ack_time);
        }
    }
}


void ble_send_ack_thread_entry(
        void *unused1,
        void *unused2,
        void *unused3) {
    while(1){
        static ble_sender_info ack_info;
        int err = k_msgq_get(&ack_receivers_q, &ack_info, K_FOREVER);
        if(err){
            printk("ERROR: Reading from ack msg queue failed.\n");
            return;
        }
        
        // Prep ack packet
        static uint8_t ack_data[] = {
            0x05, 0x05, 0x05, 0x05, 0x05 ,0x05, 0x05, 0x05
        };

        ack_data[SENDER_ID_IDX] = common_self_mesh_id;
        ack_data[MSG_TYPE_IDX] = MSG_TYPE_ACK;
        ack_data[DST_ADDR_IDX] = 0xFF; //whatever, ignored
        ack_data[RCV_ADDR_IDX] = ack_info.node_id; // node to ack to
        ack_data[TIME_STAMP_MSB_IDX] = (0xFF00 & ack_info.time_stamp) >> 8;
        ack_data[TIME_STAMP_LSB_IDX] = 0x00FF & ack_info.time_stamp;
        ack_data[TTL_IDX] = 0x01; // One jump only is allowed
        
        static struct bt_data ad_arr[] = {
            BT_DATA(0xAA, ack_data, BLE_ACK_MSG_LEN) 
        };
        
        static struct bt_le_adv_param adv_tx_params = BT_LE_ADV_PARAM_INIT(
                BT_LE_ADV_OPT_USE_IDENTITY,
                BT_GAP_ADV_FAST_INT_MIN_1,
                BT_GAP_ADV_FAST_INT_MAX_1,
                NULL);
        
        // Advertise 
        // Lock the ble device
        k_mutex_lock(&ble_send_mutex, K_FOREVER);
        
        err = bt_le_adv_start(&adv_tx_params, 
        ad_arr, ARRAY_SIZE(ad_arr), 
        NULL, 0);
        if(err) {
            printk("ERROR: could not start advertising : %d\n", err);
            return;
        }
        printk("Sending ACK to %d\n", ack_info.node_id);
        
        k_msleep(ACK_ADV_TIME_MS);
        
        err = bt_le_adv_stop();
        if(err) {
            printk("ERROR: Failed to stop advertising %d.\n", err);
            return;
        }
        printk("Finished advertising ACK\n");
        
        // Unlock to allow data sending thread to use BLE
        k_mutex_unlock(&ble_send_mutex);
    }
}


void ble_send_rt_thread_entry(struct node_t *graph) {
    while(true) {
        static uint8_t ble_data[BLE_RTR_MSG_LEN] = {0};
        static struct bt_data add_arr[] = {
            BT_DATA(0xAA, ble_data, BLE_RTR_MSG_LEN)
        };
        int err = k_msgq_get(&rtr_packets_to_send_q, &ble_data, K_FOREVER);
        if(err) {
            printk("ERROR: could not get packet from rtr_packets_to_send_q: %d\n", err);
            return;
        }
        
        // Header should not be touched as the message should be treated as
        // the same message among nodes

        static struct bt_le_adv_param adv_tx_params = BT_LE_ADV_PARAM_INIT(
                BT_LE_ADV_OPT_USE_IDENTITY,
                BT_GAP_ADV_FAST_INT_MIN_1,
                BT_GAP_ADV_FAST_INT_MAX_1,
                NULL);
        
        k_mutex_lock(&ble_send_mutex, K_FOREVER);
        err = bt_le_adv_start(&adv_tx_params, 
                add_arr, ARRAY_SIZE(add_arr),
                NULL, 0); 
        if(err) {
            printk("ERROR: could not start advertising routing table record %d.\n", err);
            return;
        }
        printk("Sending rtr, source of it is: %d\n", ble_data[SENDER_ID_IDX]);
        
        k_msleep(50);

        err = bt_le_adv_stop();
        if(err) {
            printk("ERROR: could not stop advertising routing table record %d.\n", err);
            return;
        }
        printk("Finished advertising rtr\n");
        k_mutex_unlock(&ble_send_mutex);
    }
}


/* Callbacks */
void bt_msg_received_cb(const struct bt_le_scan_recv_info *info,
              struct net_buf_simple *buf){
    char addr_str[BT_ADDR_LE_STR_LEN];
    char data[BLE_LONGEST_MSG_LEN * 2 + 1];
    
    // Check if circular buffer should be popped 
    static int64_t prev_t = 0; 
    int64_t current_t = k_uptime_get();
    int64_t delta = current_t - prev_t;
    if(delta > CB_POP_TIME_MS) { // TODO: Adjust timing of this operation 
        rcv_pkts_cb_pop(&rcv_pkts_circular_buffer);
    }
    prev_t = current_t;

    // formatting 
    bin2hex(buf->data, buf->len, data, sizeof(data));
    bt_addr_le_to_str(info->addr, addr_str, sizeof(addr_str));
    
    // Debug
    //static uint64_t messges_received_n = 0;
    //messges_received_n++;
    // printk("Received data from node with address: %s\n", addr_str);
    // printk("Data: %s\n", data);
    //printk("Number of messages received: %lld\n", messges_received_n);
    
    // Strip the buffer into simple byte array
    uint8_t ble_data[BLE_RTR_MSG_LEN] = {0}; 
    memcpy(ble_data, &(buf->data[2]), BLE_LONGEST_MSG_LEN);

    // Check if is receiver, proceed if yes
    if(ble_is_receiver(ble_data, common_self_mesh_id)){
        int err;
        uint8_t msg_type = ble_data[MSG_TYPE_IDX];
        
        // Extract sender id, timestamp and msg type to determine processing 
        // path and check if it is a duplicate 
        ble_sender_info sender_info = {
                .node_id = ble_data[SENDER_ID_IDX],
                .time_stamp = ble_get_packet_timestamp(ble_data),
                .msg_type = msg_type
        };
         
        // If packet was not received before, process it 
        if(!rcv_pkts_cb_is_in_cb(
                    &rcv_pkts_circular_buffer, &sender_info)) {
            // Decrease a TTL counter for the packet for further processing
            //ble_data[TTL_IDX]--;

            // Also add it to the recently received packets memory 
            rcv_pkts_cb_push(&rcv_pkts_circular_buffer, &sender_info);
            switch(msg_type){
                case MSG_TYPE_DATA:
                    {
                        printk("RECEIVED NEW DATA MSG from %d.\n", 
                                ble_data[SENDER_ID_IDX]);
                        
                        // Do not send ack if msg is on broadcast addr
                        if(!(ble_data[RCV_ADDR_IDX] == BROADCAST_ADDR)){
                            // Queue ack for the msg sender
                            err = k_msgq_put(&ack_receivers_q, 
                                    &sender_info, K_NO_WAIT);
                            print_msgq_num_used(&ack_receivers_q, MSG_Q_NAME(ack_receivers_q));
                            if(err){
                                printk("ERROR: Failed to put to ack \
                                        send queue\n");
                                return;
                            }
                        }
                        
                        uint8_t dst_mesh_id = ble_data[DST_ADDR_IDX];
                        if(dst_mesh_id == common_self_mesh_id) {
                            printk("FINAL DESTINATION REACHED\n");
                            // Do something with the data
                            return;
                        }
                        
                        // Queue message to process further
                        struct ble_packet_info pkt_info = {
                            .resend_counter = 0
                        };
                        memcpy(pkt_info.ble_data, ble_data, BLE_DATA_MSG_LEN);

                        err = k_msgq_put(
                                &data_packets_to_send_q, 
                                &pkt_info, K_NO_WAIT);
                        print_msgq_num_used(&data_packets_to_send_q, MSG_Q_NAME(data_packets_to_send_q));
                        if(err){ 
                            printk("Error queue put: %d, queue purged\n", err);
                            k_msgq_purge(&data_packets_to_send_q);
                            return;
                        }
                    }
                    break;

                case MSG_TYPE_ACK:
                    {
                        // Check if message's header content is correct 
                        // with awaited
                        ble_sender_info a_info;
                        err = k_msgq_peek(&awaiting_ack, &a_info);
                        if(err){
                            // This can happen when ack was received and flag was removed already, it's okay.
                            printk("ERROR: No info about awaited ack!\n");
                            printk("Data: %s\n", data);
                            return;
                        }

                        bool correct_id = a_info.node_id == ble_data[SENDER_ID_IDX];
                        uint16_t timestamp16 = sender_info.time_stamp;
                        bool correct_timestamp = timestamp16 == a_info.time_stamp;
                        if(correct_id && correct_timestamp){
                            printk("RECEIVED ACK MSG FROM: %d\n", 
                                ble_data[SENDER_ID_IDX]);
                            
                            // Wake up sending thread so it can stop transmission
                            // as ack was already received
                            k_wakeup(send_data_packet_thread_id);
                        }
                        break;
                    }
                    
                case MSG_TYPE_ROUTING_TAB:
                    // Send it further if time to live is not zero 
                    printk("RECEIVED RTR FROM %d\n", ble_data[SENDER_ID_IDX]);
                    load_rtr(graph, ble_data + HEADER_SIZE, BLE_RTR_MSG_LEN - HEADER_SIZE);
                    if(ble_data[TTL_IDX] > 1) {
                        printk("Putting the other node rtr to send queue.\n");
                        err = k_msgq_put(&rtr_packets_to_send_q, ble_data, K_NO_WAIT);
                        print_msgq_num_used(&rtr_packets_to_send_q, MSG_Q_NAME(rtr_packets_to_send_q));
                        if(err) {
                            printk("ERROR: Could not put to RTR to send queue %d \n", err);
                        }
                    }
                    
                    print_graph(graph);
                    break;
            }
        }
    }
}


/* Utility functions */
void add_self_to_rtr_queue(struct k_timer *timer) {
    uint8_t buffer[BLE_RTR_MSG_LEN] = {0};
    
    // Initialize a header 
    buffer[SENDER_ID_IDX] = common_self_mesh_id;
    buffer[MSG_TYPE_IDX] = MSG_TYPE_ROUTING_TAB;
    buffer[DST_ADDR_IDX] = 0xFF;
    buffer[RCV_ADDR_IDX] = BROADCAST_ADDR;
    ble_add_packet_timestamp(buffer);
    buffer[TTL_IDX] = MAX_TTL;
    
    node_to_byte_array(graph + common_self_mesh_id, buffer + HEADER_SIZE, BLE_RTR_MSG_LEN - HEADER_SIZE);
    
    printk("Putting the self rtr to send queue.\n");
    int err = k_msgq_put(&rtr_packets_to_send_q, buffer, K_NO_WAIT);
    print_msgq_num_used(&rtr_packets_to_send_q, MSG_Q_NAME(rtr_packets_to_send_q));
    if(err) {
        printk("ERROR: Could not put the self RTR to send queue %d\n", err);
    }
}


void rcv_pkts_cb_push(rcv_pkts_cb *cb, ble_sender_info *item) {
    *(cb->head) = *item;
    cb->head++;
    
    // Increase count
    cb->count++;
    if(cb->head == cb->buff_end) { // we dont write to end, its not valid 
        // In next call, write to the beginning of the buffer 
        cb->head = cb->buff_start;
        
        // This means, discard the first element -> shift tail if it points to 
        // that element
        if(cb->tail == cb->buff_start) cb->tail++;
        
    }
    // If head catches tail, shift tail and put it at the start if relapse
    // also decrease count, as one element was added with the cost of another 
    if(cb->head == cb->tail) {
        printk("Hi\n");
        cb->tail++;
        cb->count--;
        if(cb->tail == cb->buff_end) cb->tail = cb->buff_start;
    }
    // Test
    assert(cb->count <= cb->capacity);
}


void rcv_pkts_cb_pop(rcv_pkts_cb *cb) {
    if(cb->count > 0) {
        cb->tail++;
        if(cb->tail == cb->buff_end) cb->tail = cb->buff_start;
        cb->count--;
    }
}


bool rcv_pkts_cb_is_in_cb(rcv_pkts_cb *cb, ble_sender_info *item) {
    ble_sender_info *ptr = cb->tail;
    while(ptr != cb->head) {
        if(
                item->node_id == ptr->node_id && 
                item->time_stamp == ptr->time_stamp &&
                item->msg_type == ptr->msg_type) return true;        
        ptr++;
        if(ptr == cb->buff_end) ptr = cb->buff_start;
    }
    return false;
}


bool ble_is_receiver(uint8_t data[],uint8_t common_self_mesh_id){
    bool rec = data[RCV_ADDR_IDX] == BROADCAST_ADDR || 
            data[RCV_ADDR_IDX] == common_self_mesh_id;
    return rec;
}


uint16_t ble_add_packet_timestamp(uint8_t data[]){
    uint8_t timestamp_lower, timestamp_upper;
    uint32_t cycles32 = k_cycle_get_32();

    // Get only lower 16 bits
    timestamp_lower = 0x00FF & cycles32;
    timestamp_upper = (0xFF00 & cycles32) >> 8;
    data[TIME_STAMP_MSB_IDX] = timestamp_upper;
    data[TIME_STAMP_LSB_IDX] = timestamp_lower;
    return cycles32 & 0xFFFF;
}


uint16_t ble_get_packet_timestamp(uint8_t data[]){
    uint16_t timestamp = (data[TIME_STAMP_MSB_IDX] << 8) | 
        data[TIME_STAMP_LSB_IDX];
    return timestamp;
}


bool ble_wait_for_ack(int32_t timeout_ms) {
    int32_t time_remaining = k_msleep(timeout_ms);
    printk("Time remaining %d\n", time_remaining);
    return time_remaining > 0;
}


void print_msgq_num_used(struct k_msgq *mq, char name[]) {
    uint32_t used = k_msgq_num_used_get(mq);
    uint32_t free = k_msgq_num_free_get(mq);
    uint32_t total_size = used + free;

    printk("Message q %s is filled %d / %d \n", name, used, total_size);
}
```

## src/dijkstra.c
```c
#include "../include/dijkstra.h"
#include "../include/graph_api_generated.h"
#include <string.h>


int dijkstra_shortest_path(
        struct node_t *graph,
        uint8_t graph_size,
        uint8_t start_addr, 
        uint8_t dst_addr){ 
    int err;
    // check if right node was picked 
    if(!graph[dst_addr].reserved || !graph[start_addr].reserved){
        printk("ERROR: Node address not used!\n");
        printk("ADDRS %d and %d\n", start_addr, dst_addr);
        return -1;
    }

    if(start_addr > MAX_MESH_SIZE || start_addr < 0
            || dst_addr > MAX_MESH_SIZE || dst_addr < 0){
        printk("Incorrect search address\n");
        return -1;
    }

    /* algorithm */
    // set tentative_distance to 0 at start node  
    err = node_t_tentative_distance_set(graph + start_addr, 0);
    if(err) {
        printk("ERROR: Could not set tentative distance\n");
        return -1;
    }
    
    // create unvisited list 
    sys_slist_t lst;
    create_unvisited_slist(graph, graph_size, &lst);

    // print the result 
    //print_slist(&lst);

    // get smallest_td node and process it in a loop 
    uint8_t smallest_td_node_found_code;
    struct node_container * smallest_td_node_container;
    while(!(smallest_td_node_found_code =
                get_smallest_td_node(&lst, &smallest_td_node_container))){
        if(!smallest_td_node_container){
            printk("Smallest td node container is NULL!\n");
            return -1;
        }
        
        // visit a smallest_td node and update its neighbours td
        recalculate_td_for_neighbours(smallest_td_node_container->node->addr, graph); 

        // check if smallest_td_node_container is destination node
        if(smallest_td_node_container->node->addr == dst_addr){
            //free rest of the list
            free_slist(&lst);
            break;
        }

        // remove processed node from a list 
        remove_unvisited_slist_member(&lst, &smallest_td_node_container);
    }
    
    // trace back and record a path
    uint8_t paths_size;
    uint16_t * path;
    path = trace_back(graph, start_addr, dst_addr, &paths_size);
    
    // Path was not found -> fail
    if(!path) {
        printk("Path was not found\n");
        return -1;
    }
   
    printk("Path: \n");
    for(uint8_t i = 0; i < paths_size; i++){
        printk("%d\n", path[i]); 
    }
    
    // make all tentative_distances to INF again for future calculations
    reset_td_visited(graph); 

    // path is in reverse order, so next node from current one is
    // one before last one (last is start node) 
    int next_node_id = path[paths_size - 2];
    k_free(path);
    return next_node_id;
}


uint8_t get_smallest_td_node(
        sys_slist_t * lst, struct node_container ** container_buffer){
    // cleaer buffer // PZIE: typo
    *container_buffer = NULL;
     
    // setup 
    uint16_t smallest_td = INF;
    struct node_container * iterator;

    // check if empty
    if(sys_slist_is_empty(lst)){
        printk("List empty, returning\n");
        return 1; 
    }
    
    // find lowest_td_node
    SYS_SLIST_FOR_EACH_CONTAINER(lst, iterator, next_container_node_ptr){
        uint16_t td = 0;
        node_t_tentative_distance_get(iterator->node, &td);
        if(td <= smallest_td){
            smallest_td = td;
            *container_buffer = iterator;
        }
    }

    // if container_buffer is NULL then return error code
    if(!container_buffer) return 1;

    return 0;
}


void recalculate_td_for_neighbours(uint8_t node_addr, struct node_t *graph){
    struct node_t *current_node = graph + node_addr; 
    int err;
    for(uint8_t i = 0; i < current_node->paths_size; i++){ 
        struct node_t *neighbour = graph + ((current_node->paths + i)->addr);
         
        // consider only unvisited neighbours
        bool visited;
        node_t_visited_get(neighbour, &visited);
        if(!visited){
            struct path_t *path = current_node->paths + i;
            uint16_t cost_to_neighbour;
            path_t_cost_get(path, &cost_to_neighbour);

            // check if distance through current node is smaller than neighbour's 
            // current tentative distance
            uint16_t curr_node_td, neigh_td;
            node_t_tentative_distance_get(current_node, &curr_node_td); 
            node_t_tentative_distance_get(neighbour, &neigh_td);
            if(curr_node_td + cost_to_neighbour < neigh_td){
                err = node_t_tentative_distance_set(neighbour, 
                        curr_node_td + cost_to_neighbour);
                if(err) {
                    printk("ERROR: Could not set tentative_distance\n");
                }
            }
        }
    }
    err = node_t_visited_set(current_node, true);
    if(err) {
        printk("ERROR: Could not set visited\n");
    }
}


uint16_t * trace_back(
        struct node_t *graph,
        uint8_t start_addr, 
        uint8_t dst_addr, 
        uint8_t * paths_len){
    // array to store longest path possible TODO: make it better than that // PZIE: either make or remove todo
    uint16_t * path = k_malloc(sizeof(uint16_t) * MAX_MESH_SIZE);
    if(!path) return NULL; //PZIE: hard fail instead
 
    // tracing back
    // setup
    uint8_t index = 0;
    struct node_t * current_node = graph + dst_addr;
    
    // get to node and check its neighbours for lowest td
    path[index] = current_node->addr;
    while(current_node->addr != start_addr){ 
        // check which of neighbours has smallest td 
        uint16_t smallest_td = INF;
        uint8_t number_of_paths = current_node->paths_size; 
        struct node_t *temp_node = current_node;
        for(uint8_t i = 0; i < number_of_paths; i++){
            struct node_t * checked_node = graph + ((current_node->paths) + i)->addr;
            uint16_t checked_node_td;
            node_t_tentative_distance_get(checked_node, &checked_node_td);
            if(checked_node_td <= smallest_td){
                smallest_td = checked_node_td;
                temp_node = checked_node; // here some temp node 
            }
        }
        
        // smallest td node address add to a path 
        current_node = temp_node;
        index++;
        path[index] = current_node->addr;
        
        // If path was not found...
        if(index > MAX_MESH_SIZE) {
            k_free(path); 

            *paths_len = 0; 
            return NULL;
        }
    }

    *paths_len = index + 1;
    return path;
}


uint8_t create_unvisited_slist(struct node_t *graph, 
        uint8_t graph_size, sys_slist_t * lst){
    sys_slist_init(lst);
    for(uint8_t i = 0; i < MAX_MESH_SIZE; i++){
        if(graph[i].reserved){
            struct node_container * container = 
                k_malloc(sizeof(struct node_container));
            if(!container){
                printk("k_malloc failed in create_unvisited_list\n");
                return 1;
            }
            container->node = graph + i; 
            sys_slist_append(lst, &container->next_container_node_ptr); 
        }
    }
    return 0;
}


void free_slist(sys_slist_t * lst){
    volatile sys_snode_t * to_remove; 
    while((to_remove = sys_slist_get(lst))){
        struct node_container * container = CONTAINER_OF(
                to_remove, 
                struct node_container, 
                next_container_node_ptr);
        k_free(container);
    }
}


void remove_unvisited_slist_member(sys_slist_t * lst, struct node_container ** node_container_to_remove){
    sys_slist_find_and_remove(lst,
            &(*node_container_to_remove)->next_container_node_ptr);
    
    // free memory from heap 
    k_free(*node_container_to_remove);
}


#ifdef DEBUG

void print_slist(sys_slist_t * lst){
    struct node_container * iterator;
    printk("Printing nodes in slist: \n");
    SYS_SLIST_FOR_EACH_CONTAINER(lst, iterator, next_container_node_ptr){
        printk("Node addr: %d\n", iterator->node->addr); 
    }
    //printk("\n\n\n");
}

#endif 


















// PZIE: Is something hidden here?
```

## src/graph.c
```c
#include "../include/graph.h"
#include "../include/graph_api_generated.h"
#include "kernel.h"
#include <bluetooth/bluetooth.h>
#include <math.h>

uint8_t common_self_mesh_id = 255;

void reset_td_visited(struct node_t graph[]){
    for(uint8_t i = 0; i < MAX_MESH_SIZE; i++){
        if((graph + i)->reserved){
            node_t_tentative_distance_set(graph + i, INF);
            node_t_visited_set(graph + i, false);
        }
    }
}

// Setters and getters respecting the mutex access
int node_t_visited_set(struct node_t *node, bool new_val) {
    int err;
    err = k_mutex_lock(&node->node_mutex, K_FOREVER);
    if(err) return err;
    node->visited = new_val;
    k_mutex_unlock(&node->node_mutex);
    if(err) return err;
    return 0;
}

int node_t_visited_get(struct node_t *node, bool *ret_val) {
    int err;
    err = k_mutex_lock(&node->node_mutex, K_FOREVER);
    if(err) return err;
    *ret_val = node->visited;
    k_mutex_unlock(&node->node_mutex);
    if(err) return err;
    return 0;
}

int node_t_tentative_distance_set(struct node_t *node, uint16_t new_val) {
    int err;
    err = k_mutex_lock(&node->node_mutex, K_FOREVER);
    if(err) return err;
    node->tentative_distance = new_val;
    k_mutex_unlock(&node->node_mutex);
    if(err) return err;
    return 0;
}

int node_t_tentative_distance_get(struct node_t *node, uint16_t *ret_val) {
    int err;
    err = k_mutex_lock(&node->node_mutex, K_FOREVER);
    if(err) return err;
    *ret_val = node->tentative_distance;
    k_mutex_unlock(&node->node_mutex);
    if(err) return err;
    return 0;
}

int path_t_cost_set(struct path_t *path, uint16_t new_val){
    int err;
    err = k_mutex_lock(&path->path_mutex, K_FOREVER);
    if(err) return err;
    path->cost = new_val;
    err = k_mutex_unlock(&path->path_mutex);
    if(err) return err;
    return 0;
}

int path_t_cost_get(struct path_t *path, uint16_t *ret_val) {
    int err;
    err = k_mutex_lock(&path->path_mutex, K_FOREVER);
    if(err) return err;
    *ret_val = path->cost;
    err = k_mutex_unlock(&path->path_mutex);
    if(err) return err;
    return 0;
}

void graph_set_cost(struct node_t graph[],
        uint8_t mesh_id_1, uint8_t mesh_id_2, uint8_t new_cost){
    struct node_t *node1 = graph + mesh_id_1;
    struct node_t *node2 = graph + mesh_id_2;
    // Do it both ways 
    for(uint8_t i = 0; i < node1->paths_size; i++){
        if(node1->paths->addr == mesh_id_2){
            path_t_cost_set(node1->paths + i, new_cost);
        }
    }
    for(uint8_t i = 0; i < node2->paths_size; i++){
        if(node2->paths->addr == mesh_id_1){
            path_t_cost_set(node2->paths + i, new_cost);
        }
    }
}


// TODO: Should have some decay time, so the communication is retried //PZIE ?
/*
void node_update_missed_transmissions(struct node_t *node, 
        bool transmission_success){
    if(transmission_success && node->missed_transmissions > 0){
        node->missed_transmissions--;
    }
    else node->missed_transmissions++;
}
*/


//PZIE: Remove?
uint16_t calc_distance_from_missed_transmissions(uint64_t missed_transmissions){
    float a = 0.5; 
    float y = a * missed_transmissions * missed_transmissions + 1.0; //PZIE: seems to be quite arbitrary?
    return (uint16_t)y;
}


/* Routing table propagation */
void node_to_byte_array(struct node_t *node, uint8_t buffer[], uint8_t buffer_size) {
    // First two fields in buffer are always the same and identify the node 
    // with relation to which the rest of connections is made
    // PZIE: in general, you lack at least trivial checking, e.g. if buffer is not null. I'd say it's low prio
    buffer[0] = node->addr;
    buffer[1] = node->paths_size;

    // Rest of fields represent the connections of that node
    for(uint8_t i = 0; i < node->paths_size; i++) {
        uint8_t neighbor_addr_idx = 2 * i + 2 + 0;
        uint8_t neighbor_dist_idx = 2 * i + 2 + 1;
        uint16_t cost;
        path_t_cost_get(node->paths + i, &cost);
        buffer[neighbor_addr_idx] = (node->paths + i)->addr;
        buffer[neighbor_dist_idx] = cost;
    }
}


size_t node_get_size_in_bytes(struct node_t *node) {
    // Check if the node is reserved
    if(!node->reserved) return 0; //PZIE does it affect the _size_? Maybe this check should be elsewhere?
                                  //PZIE: Hey, is this function even used?
    
    // Include only those fields that will be sent in routing table 
    size_t byte_size = sizeof(node->addr) + sizeof(node->paths_size) 
        * (sizeof(node->paths->addr) + sizeof(node->paths->cost));
    return byte_size;
}


void load_rtr(struct node_t graph[], uint8_t buff[], uint8_t size) {
    // Each node is encoded as: 
    // addr | number of peers | peer1 addr | peer1 dist | peer2 addr | peer2 addr
    
    // First two bytes of each rtr are self addr and n neighs
    uint8_t node_addr = buff[0];
    uint8_t neighs_n = buff[1];

    // Then iterate over node neighs 
    for(uint8_t j = 0; j < neighs_n; j++) {
        uint8_t idx = 1 + 1 + (2 * j);
        if(idx > size) {
            printk("ERROR: index out of bounds when loading routing table.\n");
            return;
        }
        uint8_t neigh_addr = buff[idx];
        uint8_t neigh_dist = buff[idx + 1];
        load_node_info(&graph[node_addr], neigh_addr, neigh_dist); 
    }
}


void print_graph(struct node_t graph[]) {
    printk("Mesh topology:\n");
    uint16_t cost;
    for(uint8_t i = 0; i < MAX_MESH_SIZE; i++) {
        printk("Node %d\n", graph[i].addr);
        printk("Connected to: \n");
        for(uint8_t j = 0; j < graph[i].paths_size; j++) {
            path_t_cost_get(graph[i].paths + j, &cost);
            printk("    Node %d with distance: %d \n",
                    graph[i].paths[j].addr, cost);
        }
    }
}


void load_node_info(struct node_t *node, uint8_t neigh_addr, uint8_t cost) {
    for(uint8_t i = 0; i < node->paths_size; i++) {
        if(node->paths[i].addr == neigh_addr) {
            path_t_cost_set(node->paths + i, cost);
        }
    }
}


/* Utilities */
uint8_t identify_self_in_graph(struct node_t *graph){
    // get all configured identities 
    bt_addr_le_t identities[CONFIG_BT_ID_MAX];
    size_t *count = NULL;
    bt_id_get(NULL, count); // when addrs=null count will be loaded with num of ids //PZIE: I don't understand
    bt_id_get(identities, count);
    
    char addr_str[129]; // TODO: extract printks  // PZIE: ??
	bt_addr_le_to_str(&identities[0], addr_str, sizeof(addr_str));
    printk("Default identity: %s\n", addr_str);
    //printk("Value of DEVICEADDR[0] register: %u,\n", (NRF_FICR->DEVICEADDR[0]));

    uint8_t err = get_mesh_id_by_ble_addr(graph, addr_str, &common_self_mesh_id);
    if(err){
        printk("Error self identifying\n"); 
        return 1;
    }
    printk("Self identified in mesh as %d\n", common_self_mesh_id); 
    return 0;
}


// return 0 on succes, and > 0 on failure 
uint8_t get_mesh_id_by_ble_addr(struct node_t *graph, 
        char *ble_addr, uint8_t *mesh_id){
    // check in graph 
    for(uint8_t i = 0; i < MAX_MESH_SIZE; i++){
        if(!memcmp(graph[i].addr_bt_le, ble_addr, 17)){
            *mesh_id = graph[i].addr;
            return 0;
        }
    }
    return 1;
}
```

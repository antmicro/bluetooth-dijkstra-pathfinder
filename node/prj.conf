## CMakeLists.txt
```
cmake_minimum_required(VERSION 3.20.0)

# add variable to store max allowed ttl
SET(MAX_TTL "9" CACHE STRING "Define max time to live for a packet.")

# add variable to store topology config file path passed during west build
SET(TOPOLOGY_CONFIG_PATH "" CACHE STRING 
    "Pass path to topology .json file to c file generator")

set(BOARD nrf52840dk_nrf52840)

find_package(Zephyr REQUIRED HINTS $ENV{ZEPHYR_BASE})
project(my_zephyr_app)

target_include_directories(app PUBLIC ${include})

# build with max mesh size and max ttl specified as preprocessor #define
target_compile_definitions(app PUBLIC MAX_TTL=${MAX_TTL})

target_sources(app PRIVATE 
    src/main.c
    src/graph.c 
    src/generated-src/graph_api_generated.c
    src/dijkstra.c
    src/bluetooth_ble.c)
```

## prj.conf
```kconfig
# # PZIE: this dir is node, but we also have mobile_broadcaster. Sounds fishy
# PZIE: I'd say this file is pretty messy. Maybe have separate config files for different scenarios?
# dongle
#CONFIG_USB_DEVICE_STACK=y
#CONFIG_USB_DEVICE_PRODUCT="Zephyr USB console sample"

#CONFIG_SERIAL=y
#CONFIG_CONSOLE=y
#CONFIG_UART_CONSOLE=y
#CONFIG_UART_LINE_CTRL=y

# renode
#CONFIG_SERIAL=y
#CONFIG_UART_INTERRUPT_DRIVEN=y
#CONFIG_ZTEST=y
#CONFIG_NATIVE_UART_0_ON_STDINOUT=y
CONFIG_HEAP_MEM_POOL_SIZE=1024
CONFIG_MINIMAL_LIBC_REALLOCARRAY=y
CONFIG_MINIMAL_LIBC=y

# Combined build for BLE stack
# Minimal recommended BLE config from Zephyr docs 
CONFIG_BT=y
CONFIG_BT_HCI=y
#CONFIG_BT_HCI=y
#CONFIG_BT_CTRL=y
#CONFIG_BT_LL_SW_SPLIT=y

# Additional researched in samples
#CONFIG_BT_EXT_ADV=y # extended advertisement possibilities multiple sets
#CONFIG_BT_PER_ADV=y # periodic advertisement

# Configure as broadcaster and observer 
CONFIG_BT_BROADCASTER=y
CONFIG_BT_OBSERVER=y

#CONFIG_HWINFO=y

#CONFIG_BT_CTLR_ADV_EXT=y
#CONFIG_BT_SCAN_WITH_IDENTITY=y # enable to use directed messages 
#CONFIG_BT_PRIVACY=n

#CONFIG_BT_EXT_ADV_MAX_ADV_SET=2

CONFIG_TIMING_FUNCTIONS=y

#CONFIG_EVENTS=y

CONFIG_LOG=y
#CONFIG_BT_DEBUG_LOG=y
#CONFIG_BT_DEBUG_HCI_DRIVER=y
#CONFIG_BT_DEBUG_HCI_CORE=y
#CONFIG_LOG_BUFFER_SIZE=20000

#CONFIG_THREAD_ANALYZER=y
#CONFIG_THREAD_ANALYZER_USE_PRINTK=y
#CONFIG_THREAD_ANALYZER_AUTO=y
#CONFIG_THREAD_NAME=y
#CONFIG_BT_CTLR_TX_BUFFER_SIZE=251
#CONFIG_BT_RX_BUF_LEN=258
#CONFIG_BT_CTLR_DATA_LENGTH_MAX=251
```

## src/main.c
```c
#include <zephyr.h>
#include <sys/printk.h>
#include <drivers/uart.h>
#include <drivers/hwinfo.h>
#include <device.h>

#include "../include/graph.h"
#include "../include/dijkstra.h"
#include "../include/bluetooth_ble.h"

#define BLE_ADDR_LEN          18

// Rtr timings
#define RTR_TIMER_START_DELAY 2000
#define RTR_TIMER_PERIOD      60000

// Threads data
#define SEND_DATA_PACKET_THREAD_S_SIZE 1024
#define SEND_DATA_PACKET_THREAD_PRIO   2
K_THREAD_STACK_DEFINE(send_data_packet_thread_stack,
		      SEND_DATA_PACKET_THREAD_S_SIZE);

#define SEND_ACK_THREAD_S_SIZE 1024
#define SEND_ACK_THREAD_PRIO   1
K_THREAD_STACK_DEFINE(send_ack_thread_stack, SEND_ACK_THREAD_S_SIZE);

#define SEND_RTR_THREAD_S_SIZE 1024
#define SEND_RTR_THREAD_PRIO   6
K_THREAD_STACK_DEFINE(send_rtr_thread_stack, SEND_RTR_THREAD_S_SIZE);

K_THREAD_DEFINE(send_ack_thread, SEND_ACK_THREAD_S_SIZE,
		ble_send_ack_thread_entry, NULL, NULL, NULL,
		SEND_ACK_THREAD_PRIO, 0, 0);

// Timer to add current node to rtr propagation
K_TIMER_DEFINE(add_self_to_rtr_queue_timer, add_self_to_rtr_queue, NULL);

// Global variable so that other threads or IRQs can wake it up when necessary
k_tid_t send_data_packet_thread_id;

// Global data structure containing mesh information
struct node_t graph[MAX_MESH_SIZE];

void main(void)
{
	int err;
	// Graph Initialization
	err = graph_init(graph);
	__ASSERT(err == 0, "ERROR: Graph initialization failed (err %d)\n",
		 err);
	printk("Mesh contains %d nodes.\n", MAX_MESH_SIZE);

	// Bluetooth setup
	err = bt_enable(NULL);
	__ASSERT(err == 0, "ERROR: BLE initialization failed (err %d)\n", err);

	// Load common_self_ptr 
    char default_identity[BLE_ADDR_LEN] = { 0 };
	err = identify_self_in_graph(graph, default_identity, BLE_ADDR_LEN);
    __ASSERT(err == 0, "ERROR: Could not identify_self_in_graph (err %d)", err);
    printk("Identified self with mesh id: %d and BLE address: %s", 
            common_self_ptr->addr, default_identity); 

	struct bt_le_scan_param scan_params;
	ble_scan_setup(&scan_params);

	// Create Bluetooth LE threads
	struct k_thread send_data_packet_thread;
	send_data_packet_thread_id = k_thread_create(&send_data_packet_thread,
						     send_data_packet_thread_stack,
						     K_THREAD_STACK_SIZEOF
						     (send_data_packet_thread_stack),
						     ble_send_data_packet_thread_entry,
						     &graph, NULL, NULL,
						     SEND_DATA_PACKET_THREAD_PRIO,
						     0, K_NO_WAIT);
	k_thread_name_set(&send_data_packet_thread, "send_data_packet_thread");

	struct k_thread send_rtr_thread;
	k_thread_create(&send_rtr_thread,
			send_rtr_thread_stack,
			K_THREAD_STACK_SIZEOF
			(send_rtr_thread_stack),
			ble_send_rtr_thread_entry,
			&graph, NULL, NULL, SEND_RTR_THREAD_PRIO, 0, K_NO_WAIT);

	// Start counter that will add this node (self) to the routing table record
	// propagation thread to send to neighbors
	k_timer_start(&add_self_to_rtr_queue_timer,
		      K_MSEC(RTR_TIMER_START_DELAY), K_MSEC(RTR_TIMER_PERIOD));

	// Bluetooth scanning
	err = bt_le_scan_start(&scan_params, NULL);
	if (err) {
		printk("BLE scan error code: %d\n", err);
	}
}
```

## include/bluetooth_ble.h
```c
#ifndef BLUETOOTH_BLE_H
#define BLUETOOTH_BLE_H

#include <sys/printk.h>
#include <bluetooth/hci.h>
#include <bluetooth/bluetooth.h>
#include <bluetooth/conn.h>
#include <bluetooth/rfcomm.h>
#include <bluetooth/sdp.h>
#include <bluetooth/iso.h>
#include "graph.h"

// Header indexes definitions
#define SENDER_ID_IDX 0
#define MSG_TYPE_IDX 1
#define DST_ADDR_IDX 2
#define RCV_ADDR_IDX 3
#define TIME_STAMP_MSB_IDX 4
#define TIME_STAMP_LSB_IDX 5
#define TTL_IDX 6
#define HEADER_SIZE 7

#define MSG_TYPE_DATA 0x1
#define MSG_TYPE_ROUTING_TAB 0x2
#define MSG_TYPE_ACK 0x3

#define BROADCAST_ADDR 0x7F	// 127

#define BLE_DATA_MSG_LEN 8
#define BLE_RTR_MSG_LEN 24
#define BLE_ACK_MSG_LEN 8
#define BLE_LONGEST_MSG_LEN 24

#define RECEIVEQ_PUT_TIMEOUT_MS 10

#define CB_POP_TIME_MS 900

#define ACK_ADV_TIME_MS 100
#define DATA_ADV_TIME_MS 500

// Global variable with sender thread id to wake it up
extern k_tid_t send_data_packet_thread_id;

// Global variable for starting the add_self_to_rtr_queue_timer
extern struct k_timer add_self_to_rtr_queue_timer;

typedef struct {
	uint8_t node_id;
	uint16_t time_stamp;
	uint8_t msg_type;
} __attribute__((aligned(4))) ble_sender_info;

struct ble_packet_info {
	uint8_t ble_data[BLE_DATA_MSG_LEN];
	uint8_t resend_counter;
};

typedef struct {
	ble_sender_info *buff_start;
	ble_sender_info *buff_end;
	size_t capacity;
	size_t count;
	ble_sender_info *head;
	ble_sender_info *tail;
} rcv_pkts_cb;


/**
 * @brief Set BLE scan parameters which will be then used to start BLE scan. 
 * Register callback that will trigger on packet reception.
 *
 * @param scan_params - buffer to which params will be loaded.
 */
void ble_scan_setup(struct bt_le_scan_param *scan_params);

void ble_send_data_packet_thread_entry(struct node_t *graph);
void ble_send_ack_thread_entry();
void ble_send_rtr_thread_entry(struct node_t *graph);

// callbacks 
void bt_msg_received_cb(const struct bt_le_scan_recv_info *info,
			struct net_buf_simple *buf);

void ble_scanned(struct bt_le_ext_adv *adv,
		 struct bt_le_ext_adv_scanned_info *info);

void ble_sent(struct bt_le_ext_adv *adv, struct bt_le_ext_adv_sent_info *info);

/* Utility functions */
bool ble_is_receiver(uint8_t data[], uint8_t common_self_mesh_id);
uint16_t ble_add_packet_timestamp(uint8_t data[]);
uint16_t ble_get_packet_timestamp(uint8_t data[]);

// Timer callbacks
void add_self_to_rtr_queue(struct k_timer *timer);

// Circular buffer 
// Static initialization
#define RCV_PKTS_DEFINE(cb_name, cb_capacity) \
    ble_sender_info arr[cb_capacity]; \
    rcv_pkts_cb cb_name = {  \
        .buff_start = arr, \
        .buff_end = arr + cb_capacity,  \
        .capacity = cb_capacity, \
        .count = 0, \
        .head = arr, \
        .tail = arr\
    }
// head and tail set to arr_ptr are overkill but its done for the buff

void rcv_pkts_cb_push(rcv_pkts_cb * cb, ble_sender_info * item);
void rcv_pkts_cb_pop(rcv_pkts_cb * cb);
bool rcv_pkts_cb_is_in_cb(rcv_pkts_cb * cb, ble_sender_info * item);

bool ble_wait_for_ack(int32_t timeout_ms);

void print_msgq_num_used(struct k_msgq *mq, char name[]);

#define VAR_NAME(mq) (#mq)
#endif
```

## include/dijkstra.h
```c
#ifndef DIJKSTRA_H
#define DIJKSTRA_H

#include "../include/graph.h"

#define INF 0xFFFF

// Error code returned by dijkstra_shortest_path that is not critical and just
// means that there is no connection found between nodes.
#define ENOPATH 150

struct node_container {
	sys_snode_t next_container_node_ptr;
	struct node_t *node;
};

/**
 * @brief Use Dijkstra's algorithm to find the node that will be next hop for a packet.
 * Both start and destination nodes should be in the same graph data structure.
 *
 * @param graph][] - array containing all nodes in the network.
 * @param graph_size - length of the graph array.
 * @param start_node - pointer to the start node.
 * @param dst_node - pointer to destination node.
 *
 * @return - Mesh id of the next node or < 0 on failure. -ENOPATH is not
 * critical error, it just means that there was no path found.
 */
int dijkstra_shortest_path(struct node_t graph[],
			   uint8_t graph_size,
			   struct node_t *start_node, struct node_t *dst_node);

#endif
```

## include/graph.h
```c
#ifndef GRAPH_H
#define GRAPH_H

#include <stdint.h>
#include <stdbool.h>
#include <kernel.h>
#include <bluetooth/addr.h>
#include "graph_api_generated.h"


struct node_t {
	struct k_mutex node_mutex;
	uint8_t addr;
	char addr_bt_le[18];
	bool reserved;

	bool visited;

	uint16_t tentative_distance;

	uint8_t paths_size;
	struct path_t *paths;
};

// PZIE: I'd say this is a nice place to put comments in
extern struct node_t *common_self_ptr;
extern struct node_t graph[MAX_MESH_SIZE];

uint8_t graph_init(struct node_t *graph);

// Dijkstra's utility 
void reset_td_visited(struct node_t *graph);

// Setters and getters respecting the mutex access
int node_t_visited_set(struct node_t *node, bool new_val);
int node_t_visited_get(struct node_t *node, bool *ret_val);
int node_t_tentative_distance_set(struct node_t *node, uint16_t new_val);
int node_t_tentative_distance_get(struct node_t *node, uint16_t * ret_val);
int path_t_cost_set(struct path_t *path, uint16_t new_val);
int path_t_cost_get(struct path_t *path, uint16_t * ret_val);


/**
 * @brief Set cost from one node to another. Works in one way i.e. modifies
 * only path from node1 to node2 but not the other way around. Nodes should not
 * too eagerly change the costs for their peers on the basis of their own 
 * calculation, but rather wait for routing table record and read transition 
 * costs of peers from it.
 *
 * @param node1 - pointer to node which will have it's paths modified with new cost.
 * @param node2 - pointer that will be searched in paths of node1 to which cost will be altered.
 * @param new_cost - new cost value.
 *
 * @return - error code, 0 on success and > on mutex failure or when no such 
 * path bewteen specified nodes was found then EINVAL.
 */
int graph_set_cost_uni_direction(struct node_t *node1, struct node_t *node2, uint8_t new_cost);


/**
 * @brief Convert node's address, paths and paths size into the byte array 
 * suitable for sending with BLE.
 *
 * @param node - pointer to node which will be sent as byte array.
 * @param buffer][] - buffer to store the byte array.
 * @param buffer_size - size of a buffer.
 */
void node_to_byte_array(struct node_t *node, uint8_t buffer[],
			uint8_t buffer_size);

/**
 * @brief Load information received from peer about it's connections, received as a byte array, to 
 * current node own graph data structure.
 * Each buffer is encoded as: 
 *   B1    |        B2       |      B3    |      B4    |      B5    |     B6
 *  addr   | number of peers | peer1 addr | peer1 cost | peer2 addr | peer2 cost 
 *
 * @param graph[] - data structure to which information will be loaded.
 * @param buff[] - buffer with received data.
 * @param size - size of that buffer.
 *
 * @return - EINVAL in case value of neighs_n field in the buffer (buff[1]) was
 * too big and indexing value would be bigger than buffer size or 
 * graph_set_cost_uni_direction function failed, 0 on success and 
 * > on mutex failure 
 */
int load_rtr(struct node_t graph[], uint8_t buff[], uint8_t size);


/**
 * @brief Print the graph structure with connections in between nodes and 
 * corresponding costs.
 *
 * @param graph[] - array of struct node_t.
 */
void print_graph(struct node_t graph[]);


/**
 * @brief Finds default identity of the device (BLE address), then checks in 
 * the graph data structure for mesh id corresponding to that identity. It will
 * set the value of global pointer - common_self_ptr that points to the self in
 * the graph data structure.
 *
 * @param graph - Array with nodes.
 * @param identity_str[] - buffer that will be filled with identity string.
 * @param len - length of the buffer to fill. Should be at least 17 to handle
 * entire BLE address.
 */
void identify_self_in_graph(struct node_t *graph, char identity_str[], uint8_t len);


/**
 * @brief Iterate over graph data structure and set ptr to point to the node in
 * graph with matching ble_addr.
 *
 * @param graph - array of nodes.
 * @param ble_addr - valid BLE address matching one of the addresses in the graph
 * data structure.
 * @param ptr - pointer to pointer that will point to the resultant node.
 *
 * @return - 0 on success and EINVAL on failure.
 */
uint8_t get_mesh_id_by_ble_addr(struct node_t *graph, char *ble_addr,
				struct node_t **ptr);

#endif
```

## src/bluetooth_ble.c
```c
#include <zephyr.h>
#include <kernel/thread_stack.h>
#include "kernel.h"
#include <timing/timing.h>
#include <assert.h>
#include "../include/dijkstra.h"
#include "../include/bluetooth_ble.h"
#include "../include/graph_api_generated.h"

// Holds single instance of info about awaited ack message
K_MSGQ_DEFINE(awaiting_ack, sizeof(ble_sender_info), 1, 4);

// Queues for threads sending messages
K_MSGQ_DEFINE(ack_receivers_q, sizeof(ble_sender_info), 10, 4);
K_MSGQ_DEFINE(data_packets_to_send_q, sizeof(struct ble_packet_info), 10, 4);
K_MSGQ_DEFINE(rtr_packets_to_send_q, BLE_RTR_MSG_LEN, 10, 4);

K_MUTEX_DEFINE(ble_dev_mutex);
K_MUTEX_DEFINE(graph_mutex);

// Static initialization of circular buffer with recently received packets
RCV_PKTS_DEFINE(rcv_pkts_circular_buffer, 10);


void ble_scan_setup(struct bt_le_scan_param *scan_params)
{
	*(scan_params) = (struct bt_le_scan_param) {
		.type = BT_LE_SCAN_TYPE_PASSIVE,
		.options = BT_LE_SCAN_OPT_NONE,	//BT_LE_SCAN_OPT_CODED |
		.interval = 0x0060,
		.window = 0x0060
	};

	// register a callback for packet reception
	static struct bt_le_scan_cb scan_callbacks = {
		.recv = bt_msg_received_cb,
	};
	bt_le_scan_cb_register(&scan_callbacks);
}

// Thread entries
void ble_send_data_packet_thread_entry(struct node_t *graph)
{
	while (1) {
		struct ble_packet_info pkt_info;
		struct bt_data ad_arr[] = {
			BT_DATA(0xAA, pkt_info.ble_data, BLE_DATA_MSG_LEN)
		};
		int err;

		// Get the packet content from the queue
		err = k_msgq_get(&data_packets_to_send_q, &pkt_info, K_FOREVER);
        __ASSERT(err == 0, "ERROR: Could not get data from data packets messageq (err %d)\n", err);

		// Message preparation
		// Calculate shortest path with Dijkstra algorithm
		uint8_t dst_mesh_id = pkt_info.ble_data[DST_ADDR_IDX];
		int next_node_mesh_id =
		    dijkstra_shortest_path(graph, MAX_MESH_SIZE,
					   common_self_ptr,
					   &graph[dst_mesh_id]);
        struct node_t *next_node = &graph[next_node_mesh_id];
		if (next_node_mesh_id < 0) {
			printk("Dijkstra algorithm failed (err %d)\n", next_node_mesh_id);
            __ASSERT(next_node_mesh_id == -ENOPATH, "ERROR: Critical fail in Dijkstra's algorithm\n", err);
			continue;
		}
		printk("Next hop: %d\n", next_node_mesh_id);

		// Header settings
		pkt_info.ble_data[SENDER_ID_IDX] = common_self_ptr->addr;
		pkt_info.ble_data[RCV_ADDR_IDX] = next_node_mesh_id;
		pkt_info.ble_data[TTL_IDX] = 0x01;	// one jump allowed
		uint16_t timestamp =
		    ble_add_packet_timestamp(pkt_info.ble_data);

		// Awaiting ack for this packet
		ble_sender_info ack_info = {
			.node_id = next_node_mesh_id,
			.time_stamp = timestamp,
			.msg_type = 0x0	// Unused here
		};
		err = k_msgq_put(&awaiting_ack, &ack_info, K_NO_WAIT);
        __ASSERT(err == 0,"ERROR: Failed to put into awaiting_ack q (err %d)\n", err);
		printk("Awaiting for ack from node %d and with timestamp: %d\n",
		       ack_info.node_id, ack_info.time_stamp);

        // Print how much free space left in the queue
        print_msgq_num_used(&awaiting_ack, VAR_NAME(awaiting_ack));

		// Init adv params
		struct bt_le_adv_param adv_tx_params =
		    BT_LE_ADV_PARAM_INIT(BT_LE_ADV_OPT_USE_IDENTITY,
					 BT_GAP_ADV_FAST_INT_MIN_1,
					 BT_GAP_ADV_FAST_INT_MAX_1,
					 NULL);

		// Lock the ble device
		k_mutex_lock(&ble_dev_mutex, K_FOREVER);

		// Sending a data message
		err = bt_le_adv_start(&adv_tx_params,
				      ad_arr, ARRAY_SIZE(ad_arr), NULL, 0);
        // In general there should be no errors in handling BLE device
        // so we do not recover if one occurs
        __ASSERT(err == 0, "ERROR: could not start advertising (err %d)\n", err);
		printk("Started advertising a data packet.\n");

		// Wait for ack
		uint32_t time_left = k_msleep(DATA_ADV_TIME_MS);
		bool got_ack = time_left > 0;

		err = bt_le_adv_stop();
		__ASSERT(err == 0, "ERROR: Failed to stop advertising (err %d)\n", err);
		printk("Finished advertising a data packet.\n");

		// Release the device for ack thread or rtr thread to use
		k_mutex_unlock(&ble_dev_mutex);

		pkt_info.resend_counter++;
		printk("Resend counter: %d\n", pkt_info.resend_counter);

		// Remove flag indicating awaited ack
		ble_sender_info unused;
		err = k_msgq_get(&awaiting_ack, &unused, K_MSEC(50));

		// Cost recalculation and update
		struct path_t *used_path;
		for (uint8_t i = 0; i < common_self_ptr->paths_size;
		     i++) {
			if (common_self_ptr->paths[i].node_ptr == next_node) {
				used_path = &common_self_ptr->paths[i];
			}
		}

		uint16_t signal_str, phy_distance, missed_transmissions;
		path_t_missed_transmissions_get(used_path,
						&missed_transmissions);
        path_t_signal_str_get(used_path, &signal_str);
		path_t_phy_distance_get(used_path, &phy_distance);
        // If acknowledge was not received increase the number of missed transmissions
        if(!got_ack) {
            missed_transmissions += 1;
        }
        else {
            if(missed_transmissions > 1) {
                missed_transmissions -= 1;
            }
        }
        path_t_missed_transmissions_set(used_path, missed_transmissions);
		uint16_t new_cost =
		    calc_cost(signal_str, phy_distance, missed_transmissions);

		err = graph_set_cost_uni_direction(common_self_ptr, next_node, new_cost);
        if(err) {
            printk("WARNING: Could not set transition cost between %d and %d (err %d)", 
                    common_self_ptr->addr, next_node->addr, err);
            continue;
        }
		printk("New calculated transition cost: %d\n", new_cost);

		// Put the message again into the queue and try to send it again
		if (!got_ack) {
			printk("##############################\n");
			printk("Did not receive ACK from node %d.\n",
			       pkt_info.ble_data[RCV_ADDR_IDX]);
			printk("##############################\n");

			// Do not resend infinitely
			if (pkt_info.resend_counter < 3)
				k_msgq_put(&data_packets_to_send_q,
					   pkt_info.ble_data, K_NO_WAIT);
			print_msgq_num_used(&data_packets_to_send_q,
					    VAR_NAME(data_packets_to_send_q));
		}
		// Wait for the other node acknowledging to finish to so that not to 
		// flood it with new messages
		uint32_t data_adv_time = DATA_ADV_TIME_MS - time_left;
		if (data_adv_time < ACK_ADV_TIME_MS) {
			uint32_t wait_till_ack_time =
			    ACK_ADV_TIME_MS - data_adv_time;
			printk
			    ("Waiting with sending another data packet for node %d to finish ACKing for %dms\n",
			     next_node_mesh_id, wait_till_ack_time);
			k_msleep(wait_till_ack_time);
		}
	}
}

void ble_send_ack_thread_entry(void *unused1, void *unused2, void *unused3)
{
	while (1) {
		static ble_sender_info ack_info;
		int err = k_msgq_get(&ack_receivers_q, &ack_info, K_FOREVER);
		if (err) {
			printk("ERROR: Reading from ack msg queue failed.\n");
			return;
		}
		// Prep ack packet
		static uint8_t ack_data[] = {
			0x05, 0x05, 0x05, 0x05, 0x05, 0x05, 0x05, 0x05
		};

		ack_data[SENDER_ID_IDX] = common_self_ptr->addr;
		ack_data[MSG_TYPE_IDX] = MSG_TYPE_ACK;
		ack_data[DST_ADDR_IDX] = 0xFF;	//whatever, ignored
		ack_data[RCV_ADDR_IDX] = ack_info.node_id;	// node to ack to
		ack_data[TIME_STAMP_MSB_IDX] =
		    (0xFF00 & ack_info.time_stamp) >> 8;
		ack_data[TIME_STAMP_LSB_IDX] = 0x00FF & ack_info.time_stamp;
		ack_data[TTL_IDX] = 0x01;	// One jump only is allowed

		static struct bt_data ad_arr[] = {
			BT_DATA(0xAA, ack_data, BLE_ACK_MSG_LEN)
		};

		static struct bt_le_adv_param adv_tx_params =
		    BT_LE_ADV_PARAM_INIT(BT_LE_ADV_OPT_USE_IDENTITY,
					 BT_GAP_ADV_FAST_INT_MIN_1,
					 BT_GAP_ADV_FAST_INT_MAX_1,
					 NULL);

		// Advertise 
		// Lock the ble device
		k_mutex_lock(&ble_dev_mutex, K_FOREVER);

		err = bt_le_adv_start(&adv_tx_params,
				      ad_arr, ARRAY_SIZE(ad_arr), NULL, 0);
		if (err) {
			printk("ERROR: could not start advertising : %d\n",
			       err);
			return;
		}
		printk("Sending ACK to %d\n", ack_info.node_id);

		k_msleep(ACK_ADV_TIME_MS);	//PZIE: controversial

		err = bt_le_adv_stop();
		if (err) {
			printk("ERROR: Failed to stop advertising %d.\n", err);
			return;
		}
		printk("Finished advertising ACK\n");

		// Unlock to allow data sending thread to use BLE
		k_mutex_unlock(&ble_dev_mutex);
	}
}

void ble_send_rtr_thread_entry(struct node_t *graph)
{
	while (true) {
		static uint8_t ble_data[BLE_RTR_MSG_LEN] = { 0 };
		static struct bt_data add_arr[] = {
			BT_DATA(0xAA, ble_data, BLE_RTR_MSG_LEN)
		};
		int err =
		    k_msgq_get(&rtr_packets_to_send_q, &ble_data, K_FOREVER);
		if (err) {
			printk
			    ("ERROR: could not get packet from rtr_packets_to_send_q: %d\n",
			     err);
			return;
		}
		// Header should not be touched as the message should be treated as
		// the same message among nodes

		static struct bt_le_adv_param adv_tx_params =
		    BT_LE_ADV_PARAM_INIT(BT_LE_ADV_OPT_USE_IDENTITY,
					 BT_GAP_ADV_FAST_INT_MIN_1,
					 BT_GAP_ADV_FAST_INT_MAX_1,
					 NULL);

		k_mutex_lock(&ble_dev_mutex, K_FOREVER);
		err = bt_le_adv_start(&adv_tx_params,
				      add_arr, ARRAY_SIZE(add_arr), NULL, 0);
		if (err) {
			printk
			    ("ERROR: could not start advertising routing table record %d.\n",
			     err);
			return;
		}
		printk("Sending rtr, source of it is: %d\n",
		       ble_data[SENDER_ID_IDX]);

		k_msleep(50);

		err = bt_le_adv_stop();
		if (err) {
			printk
			    ("ERROR: could not stop advertising routing table record %d.\n",
			     err);
			return;
		}
		printk("Finished advertising rtr\n");
		k_mutex_unlock(&ble_dev_mutex);
	}
}

/* Callbacks */
void bt_msg_received_cb(const struct bt_le_scan_recv_info *info,
		   struct net_buf_simple *buf)
{
	char addr_str[BT_ADDR_LE_STR_LEN];
	char data[BLE_LONGEST_MSG_LEN * 2 + 1];

	// Check if circular buffer should be popped 
	static int64_t prev_t = 0;
	int64_t current_t = k_uptime_get();
	int64_t delta = current_t - prev_t;
	if (delta > CB_POP_TIME_MS) {	// TODO: Adjust timing of this operation 
		rcv_pkts_cb_pop(&rcv_pkts_circular_buffer);
	}
	prev_t = current_t;

	// formatting 
	bin2hex(buf->data, buf->len, data, sizeof(data));
	bt_addr_le_to_str(info->addr, addr_str, sizeof(addr_str));
    
    if(false) {
        static uint64_t messges_received_n = 0;
        messges_received_n++;
        printk("Received data from node with address: %s\n", addr_str);
        printk("Data: %s\n", data);
        printk("Number of messages received: %lld\n", messges_received_n);
    }

	// Strip the buffer into simple byte array
	uint8_t ble_data[BLE_RTR_MSG_LEN] = { 0 };
	memcpy(ble_data, &(buf->data[2]), BLE_LONGEST_MSG_LEN);

	// Check if is receiver, proceed if yes
	if (ble_is_receiver(ble_data, common_self_ptr->addr)) {
		int err;
		uint8_t msg_type = ble_data[MSG_TYPE_IDX];

		// Extract sender id, timestamp and msg type to determine processing 
		// path and check if it is a duplicate 
		ble_sender_info sender_info = {
			.node_id = ble_data[SENDER_ID_IDX],
			.time_stamp = ble_get_packet_timestamp(ble_data),
			.msg_type = msg_type
		};

		// If packet was not received before, process it 
		if (!rcv_pkts_cb_is_in_cb
		    (&rcv_pkts_circular_buffer, &sender_info)) {
			// Decrease a TTL counter for the packet for further processing 
			ble_data[TTL_IDX]--;

			// Also add it to the recently received packets memory 
			rcv_pkts_cb_push(&rcv_pkts_circular_buffer,
					 &sender_info);
			switch (msg_type) {
			case MSG_TYPE_DATA:
				{
					printk
					    ("RECEIVED NEW DATA MSG from %d.\n",
					     ble_data[SENDER_ID_IDX]);

					// Do not send ack if msg is on broadcast addr
					if (!
					    (ble_data[RCV_ADDR_IDX] ==
					     BROADCAST_ADDR)) {
						// Queue ack for the msg sender
						err =
						    k_msgq_put(&ack_receivers_q,
							       &sender_info,
							       K_NO_WAIT);
						print_msgq_num_used
						    (&ack_receivers_q,
						     VAR_NAME
						     (ack_receivers_q));
						if (err) {
							printk
							    ("ERROR: Failed to put to ack \
                                        send queue\n");
							return;
						}
					}

					uint8_t dst_mesh_id =
					    ble_data[DST_ADDR_IDX];
					if (dst_mesh_id == common_self_ptr->addr) {
						printk
						    ("FINAL DESTINATION REACHED\n");
						// Do something with the data
						return;
					}
					// Queue message to process further
					struct ble_packet_info pkt_info = {
						.resend_counter = 0
					};
					memcpy(pkt_info.ble_data, ble_data,
					       BLE_DATA_MSG_LEN);

					err =
					    k_msgq_put(&data_packets_to_send_q,
						       &pkt_info, K_NO_WAIT);
					print_msgq_num_used
					    (&data_packets_to_send_q,
					     VAR_NAME
					     (data_packets_to_send_q));
					if (err) {
						printk
						    ("Error queue put: %d, queue purged\n",
						     err);
						k_msgq_purge
						    (&data_packets_to_send_q);
						return;
					}
				}
				break;

			case MSG_TYPE_ACK:
				{
					// Check if received message's header matches the one we await
					ble_sender_info a_info;
					err =
					    k_msgq_peek(&awaiting_ack, &a_info);
					if (err) {
						// This can happen when ack was received and flag was removed already, it's okay. 
						printk
						    ("WARNING: No info about awaited ack!\n");
						printk("Data: %s\n", data);
						return;
					}

					bool correct_id =
					    a_info.node_id ==
					    ble_data[SENDER_ID_IDX];
					uint16_t timestamp16 =
					    sender_info.time_stamp;
					bool correct_timestamp =
					    timestamp16 == a_info.time_stamp;
					if (correct_id && correct_timestamp) {
						printk
						    ("RECEIVED ACK MSG FROM: %d\n",
						     ble_data[SENDER_ID_IDX]);

						// Wake up sending thread so it can stop transmission
						// as ack was already received
						k_wakeup
						    (send_data_packet_thread_id);
					}
					break;
				}

			case MSG_TYPE_ROUTING_TAB:
				// Send it further if time to live is not zero 
				printk("RECEIVED RTR FROM %d\n",
				       ble_data[SENDER_ID_IDX]);
				load_rtr(graph, ble_data + HEADER_SIZE,
					 BLE_RTR_MSG_LEN - HEADER_SIZE);
				if (ble_data[TTL_IDX] > 1) {
					printk
					    ("Putting the other node rtr to send queue.\n");
					err =
					    k_msgq_put(&rtr_packets_to_send_q,
						       ble_data, K_NO_WAIT);
					print_msgq_num_used
					    (&rtr_packets_to_send_q,
					     VAR_NAME(rtr_packets_to_send_q));
					if (err) {
						printk
						    ("ERROR: Could not put to RTR to send queue %d \n",
						     err);
					}
				}

				print_graph(graph);
				break;
			}
		}
	}
}

void add_self_to_rtr_queue(struct k_timer *timer)
{
    int err;
    __ASSERT(timer != NULL, "ERROR: Timer pointer is NULL\n");
	uint8_t buffer[BLE_RTR_MSG_LEN] = { 0 };

	// Initialize a header 
	buffer[SENDER_ID_IDX] = common_self_ptr->addr;
	buffer[MSG_TYPE_IDX] = MSG_TYPE_ROUTING_TAB;
	buffer[DST_ADDR_IDX] = 0xFF;
	buffer[RCV_ADDR_IDX] = BROADCAST_ADDR;
	ble_add_packet_timestamp(buffer);
	buffer[TTL_IDX] = MAX_TTL;

	err = node_to_byte_array(common_self_ptr, buffer + HEADER_SIZE,
			   BLE_RTR_MSG_LEN - HEADER_SIZE);

	printk("Putting the self rtr to send queue.\n");
	err = k_msgq_put(&rtr_packets_to_send_q, buffer, K_NO_WAIT);
	print_msgq_num_used(&rtr_packets_to_send_q,
			    VAR_NAME(rtr_packets_to_send_q));
	if (err) {
		printk("ERROR: Could not put the self RTR to send queue %d\n",
		       err);
	}
}

void rcv_pkts_cb_push(rcv_pkts_cb * cb, ble_sender_info * item)
{
    __ASSERT(cb != NULL, "ERROR: circullar buffer is NULL\n");
    __ASSERT(item != NULL, "ERROR: sender info is NULL\n");

	*(cb->head) = *item;
	cb->head++;

	// Increase count
	cb->count++;
	if (cb->head == cb->buff_end) {	// we dont write to end, its not valid 
		// In next call, write to the beginning of the buffer 
		cb->head = cb->buff_start;
    }
	// If head catches tail, shift tail and put it at the start if relapse
	// also decrease count, as one element was added with the cost of another 
	if (cb->head == cb->tail) {
		cb->tail++;
		cb->count--;
		if (cb->tail == cb->buff_end)
			cb->tail = cb->buff_start;
	}
	// Test
	assert(cb->count <= cb->capacity);
}

void rcv_pkts_cb_pop(rcv_pkts_cb * cb)
{
	if (cb->count > 0) {
		cb->tail++;
		if (cb->tail == cb->buff_end)
			cb->tail = cb->buff_start;
		cb->count--;
	}
}

bool rcv_pkts_cb_is_in_cb(rcv_pkts_cb * cb, ble_sender_info * item)
{
	ble_sender_info *ptr = cb->tail;
	while (ptr != cb->head) {
		if (item->node_id == ptr->node_id &&
		    item->time_stamp == ptr->time_stamp &&
		    item->msg_type == ptr->msg_type)
			return true;
		ptr++;
		if (ptr == cb->buff_end)
			ptr = cb->buff_start;
	}
	return false;
}

bool ble_is_receiver(uint8_t data[], uint8_t id)
{
    __ASSERT(data != NULL, "ERROR: Data buffer is NULL\n");
	bool rec = data[RCV_ADDR_IDX] == BROADCAST_ADDR ||
	    data[RCV_ADDR_IDX] == id;
	return rec;
}

uint16_t ble_add_packet_timestamp(uint8_t data[])
{
    __ASSERT(data != NULL, "ERROR: Data buffer is NULL\n");
	uint8_t timestamp_lower, timestamp_upper;
	uint32_t cycles32 = k_cycle_get_32();

	// Get only lower 16 bits
	timestamp_lower = 0x00FF & cycles32;
	timestamp_upper = (0xFF00 & cycles32) >> 8;
	data[TIME_STAMP_MSB_IDX] = timestamp_upper;
	data[TIME_STAMP_LSB_IDX] = timestamp_lower;
	return cycles32 & 0xFFFF;
}

uint16_t ble_get_packet_timestamp(uint8_t data[])
{
	uint16_t timestamp = (data[TIME_STAMP_MSB_IDX] << 8) |
	    data[TIME_STAMP_LSB_IDX];
	return timestamp;
}

bool ble_wait_for_ack(int32_t timeout_ms)
{
	int32_t time_remaining = k_msleep(timeout_ms);
	printk("Time remaining %d\n", time_remaining);	//PZIE: stretch goal - use Zephyr's logging infra
	return time_remaining > 0;
}

void print_msgq_num_used(struct k_msgq *mq, char name[])
{
	uint32_t used = k_msgq_num_used_get(mq);
	uint32_t free = k_msgq_num_free_get(mq);
	uint32_t total_size = used + free;

	printk("Message q %s is filled %d / %d \n", name, used, total_size);
}
```

## src/dijkstra.c
```c
#include "../include/dijkstra.h"
#include "../include/graph_api_generated.h"
#include <string.h>
#include <stdlib.h>


/**
 * @brief Gets a pointer to conatiner from unvisited list with the node that has
 * smallest tentative distance.
 *
 * @param lst - pointer to sys_slist_t data structure.
 * @param container_buffer - return buffer.
 *
 * @return - status code, -EINVAL on failure or 0 on success.
 */
static int get_smallest_td_node(sys_slist_t * lst,
			     struct node_container **container_buffer);

/**
 * @brief Visit neighboring nodes of the current node one by one and calculate the distance 
 * to them through the current node. If it is smaller than the current tentative_distance of 
 * the neighbor, update it.
 *
 * @param current_node - pointer to the node of which neighbors should be checked.
 *
 * @return - 0 on success and other on failure.
 */
static int recalculate_td_for_neighbours(struct node_t *current_node);

/**
 * @brief After calculating tentative_distances with Dijkstra algorithm, 
 * analyze graph and trace back path fomr the dst node to start node,
 * following the path of lowest tentative_distances.
 *
 * @param start_node - pointer to starting node.
 * @param dst_node - pointer to destination node.
 * @param paths_len - return buffer storing the length of the path. 
 *
 * @return - malloced array of consequent nodes mesh ids. It is user's 
 * responsibility to call free(). On failure NULL.
 */
static uint8_t *trace_back(struct node_t *start_node, struct node_t *dst_node, uint8_t * paths_len);


/**
 * @brief Create a singly linked list of nodes in the graph that were not 
 * visited yet during the Dijkstra algorithm.
 *
 * @param graph - array containing all nodes in the network.
 * @param graph_size - size of the graph.
 * @param lst - pointer to uninitialized list that will be initialized.
 *
 * @return - 0 on success != 0 on failure.
 */
static int create_unvisited_slist(struct node_t graph[],
			       uint8_t graph_size, sys_slist_t * lst);


/**
 * @brief At the end of the Dijkstra algorithm free malloced for slist memory.
 *
 * @param lst - list to be freed.
 */
static void free_slist(sys_slist_t * lst);


/**
 * @brief Remove a node that was visited from the unvisited list.
 *
 * @param lst - pointer to unvisited list.
 * @param node_to_remove - pointer to pointer of type node container to remove.
 */
static void remove_unvisited_slist_member(sys_slist_t * lst,
				   struct node_container **node_to_remove);


int dijkstra_shortest_path(struct node_t graph[],
			   uint8_t graph_size,
			   struct node_t *start_node, struct node_t *dst_node)
{
	int err;
    if(!graph || !start_node || !dst_node) return -EINVAL;

	// check if right node was picked
	if (!start_node->reserved || !dst_node->reserved) {
		printk("ERROR: Node address not used!\n");
		printk("Provided addresses %d and %d\n", start_node->addr, dst_node->addr);
		return -EINVAL;
	}
	if (start_node->addr > MAX_MESH_SIZE || start_node->addr < 0
	    || dst_node->addr > MAX_MESH_SIZE || dst_node->addr < 0) {
		printk("Incorrect search address\n");
		return -EINVAL;
	}

	// set tentative_distance to 0 at start node
	err = node_t_tentative_distance_set(start_node, 0);
	if (err) {
		printk("ERROR: Could not set tentative distance\n");
		return err;
	}

	sys_slist_t lst;
	err = create_unvisited_slist(graph, graph_size, &lst);
    if(err) {
        printk("ERROR: Could not create list of unvisited nodes\n");
        return err;
    }

	// get smallest_td node and process it in a loop
	int smallest_td_node_found_code;
	struct node_container *smallest_td_node_container;
	while (!(smallest_td_node_found_code =
		 get_smallest_td_node(&lst, &smallest_td_node_container))) {
		if (!smallest_td_node_container) {
			printk("Smallest td node container is NULL!\n");
			return -EINVAL;
		}
		// visit a smallest_td node and update its neighbours td
        err = recalculate_td_for_neighbours(smallest_td_node_container->node);
        if (err) return err;

        // If found destination
		if (smallest_td_node_container->node->addr == dst_node->addr) {
			free_slist(&lst);
			break;
		}
		// remove processed node from a list
		remove_unvisited_slist_member(&lst,
					      &smallest_td_node_container);
	}

	// trace back and record a path
	uint8_t paths_size;
	uint8_t *path;
	path = trace_back(start_node, dst_node, &paths_size);

	if (!path) {
		printk("ERROR: Path was not found\n");
		return -EINVAL;
	}
    
    // Visualize path
	printk("Path: \n");
	for (int i = paths_size - 1; i >= 0; i--) {
		printk("%d", path[i]);
        if(i != 0) {
            printk("->");
        }
        else {
            printk("\n");
        }
	}

	// make all tentative_distances to INF again for future calculations
	err = reset_td_visited(graph, MAX_MESH_SIZE);
    __ASSERT(err == 0, "ERROR: Could not reset tentative_distances in the graph (err %d)\n", err);

	// path is in reverse order, so next node from current one is
	// one before last one (last is start node)
	int next_node_id = path[paths_size - 2];
	k_free(path);
	return next_node_id;
}

int get_smallest_td_node(sys_slist_t * lst,
			     struct node_container **container_buffer)
{
    int err;
	uint16_t smallest_td = INF;
	struct node_container *iterator;
    
    if(!lst || !container_buffer) return -EINVAL;

	*container_buffer = NULL;
	if (sys_slist_is_empty(lst)) {
		return -EINVAL;
	}

	// find lowest_td_node
	SYS_SLIST_FOR_EACH_CONTAINER(lst, iterator, next_container_node_ptr) {
		uint16_t td;
		err = node_t_tentative_distance_get(iterator->node, &td);
        if(err) return err;
		
        if (td <= smallest_td) {
			smallest_td = td;
			*container_buffer = iterator;
		}
	}

	if (!container_buffer) return -EINVAL;
    
	return 0;
}

static int recalculate_td_for_neighbours(struct node_t *current_node)
{
    int err;
    if(!current_node) return -EINVAL;
	for (uint8_t i = 0; i < current_node->paths_size; i++) {
		struct node_t *neighbour = (current_node->paths + i)->node_ptr;

		// consider only unvisited neighbours
		bool visited;
		err = node_t_visited_get(neighbour, &visited);
        if(err) return err;
		
        if (!visited) {
			struct path_t *path = current_node->paths + i;
			uint16_t cost_to_neighbour;
			err = path_t_cost_get(path, &cost_to_neighbour);
            if(err) return err;

			// check if distance through current node is smaller than neighbour's
			// current tentative distance
			uint16_t curr_node_td, neigh_td;
			err = node_t_tentative_distance_get(current_node,
						      &curr_node_td);
            if(err) return err;
			node_t_tentative_distance_get(neighbour, &neigh_td);
			if (curr_node_td + cost_to_neighbour < neigh_td) {
				err = node_t_tentative_distance_set(neighbour,
								    curr_node_td
								    +
								    cost_to_neighbour);
                if(err) return err;
			}
		}
	}
	err = node_t_visited_set(current_node, true);
    if(err) return err;
    return 0;
}

static uint8_t *trace_back(struct node_t *start_node, struct node_t *dst_node, uint8_t * paths_len)
{
    uint8_t index = 0;
    int err;
	struct node_t *current_node = dst_node;

    if(!start_node || !dst_node) return NULL;
	
    // array to store longest path possible, it will be realloc'ed in the end to correct size
	uint8_t *path = k_malloc(sizeof(uint8_t) * MAX_MESH_SIZE);
    __ASSERT(path != NULL, "ERROR: Could not allocate memory for path tracing\n");

	// get to node and check its neighbours for lowest td
	path[index] = current_node->addr;
	while (current_node != start_node) {
		// check which of neighbours has smallest td
		uint16_t smallest_td = INF;
		uint8_t number_of_paths = current_node->paths_size;
		struct node_t *temp_node = current_node;
		for (uint8_t i = 0; i < number_of_paths; i++) {
			struct node_t *checked_node =
			     ((current_node->paths) + i)->node_ptr;
			uint16_t checked_node_td;
			err = node_t_tentative_distance_get(checked_node,
						      &checked_node_td);
			if (checked_node_td <= smallest_td) {
				smallest_td = checked_node_td;
				temp_node = checked_node;	// here some temp node
			}
		}

        // Pick neighbor with smallest td and set it as current node
		// smallest td node address add to a path and set it as current node
		current_node = temp_node;
		index++;
		path[index] = current_node->addr;

		// If path was not found...
		if (index > MAX_MESH_SIZE) {
			k_free(path);

			*paths_len = 0;
			return NULL;
		}
	}

	*paths_len = index + 1;
    realloc(path, (*paths_len) * sizeof(uint8_t));
    printk("Memory %d\n", sizeof(uint8_t) * (*paths_len));
    __ASSERT(path != NULL, "ERROR: Could not reallocate memory for path tracing\n");
	return path;
}

static int create_unvisited_slist(struct node_t graph[],
			       uint8_t graph_size, sys_slist_t * lst)
{
    if(!graph || !lst) return -EINVAL;
	sys_slist_init(lst);
	for (uint8_t i = 0; i < graph_size; i++) {
		if (graph[i].reserved) {
			struct node_container *container =
			    k_malloc(sizeof(struct node_container));
            __ASSERT(container != NULL, "ERROR: Could not allocate memory for node container \n");
			container->node = graph + i;
			sys_slist_append(lst,
					 &container->next_container_node_ptr);
		}
	}
	return 0;
}

static void free_slist(sys_slist_t * lst)
{
	volatile sys_snode_t *to_remove;
	while ((to_remove = sys_slist_get(lst))) {
		struct node_container *container = CONTAINER_OF(to_remove,
								struct
								node_container,
								next_container_node_ptr);
		k_free(container);
	}
}

static void remove_unvisited_slist_member(sys_slist_t * lst, struct node_container
				   **node_container_to_remove)
{
	sys_slist_find_and_remove(lst,
				  &
				  (*node_container_to_remove)->next_container_node_ptr);
	k_free(*node_container_to_remove);
}
```

## src/graph.c
```c
#include "../include/graph.h"
#include "../include/dijkstra.h"
#include "kernel.h"
#include <bluetooth/bluetooth.h>
#include <math.h>
#include "../include/graph_api_generated.h"


/**
 * @brief Global variable that is set to point to self after intialization phase.
 */
struct node_t *common_self_ptr = NULL;

int reset_td_visited(struct node_t graph[], uint8_t size)
{
    if(!graph) return -EINVAL;
	for (uint8_t i = 0; i < size; i++) {
		if ((graph + i)->reserved) {
			node_t_tentative_distance_set(graph + i, INF);
			node_t_visited_set(graph + i, false);
		}
	}
    return 0;
}

// Setters and getters respecting the mutex access
int node_t_visited_set(struct node_t *node, bool new_val)
{
	int err;
    if(!node) return -EINVAL;
	err = k_mutex_lock(&node->node_mutex, K_FOREVER);
	if (err)
		return err;
	node->visited = new_val;
	k_mutex_unlock(&node->node_mutex);
	if (err)
		return err;
	return 0;
}

int node_t_visited_get(struct node_t *node, bool *ret_val)
{
	int err;
    if(!node || !ret_val) return -EINVAL;
	err = k_mutex_lock(&node->node_mutex, K_FOREVER);
	if (err)
		return err;
	*ret_val = node->visited;
	k_mutex_unlock(&node->node_mutex);
	if (err)
		return err;
	return 0;
}

int node_t_tentative_distance_set(struct node_t *node, uint16_t new_val)
{
	int err;
    if(!node) return -EINVAL;
	err = k_mutex_lock(&node->node_mutex, K_FOREVER);
	if (err)
		return err;
	node->tentative_distance = new_val;
	k_mutex_unlock(&node->node_mutex);
	if (err)
		return err;
	return 0;
}

int node_t_tentative_distance_get(struct node_t *node, uint16_t * ret_val)
{
	int err;
    if(!node || !ret_val) return -EINVAL;
	err = k_mutex_lock(&node->node_mutex, K_FOREVER);
	if (err)
		return err;
	*ret_val = node->tentative_distance;
	k_mutex_unlock(&node->node_mutex);
	if (err)
		return err;
	return 0;
}

int path_t_cost_set(struct path_t *path, uint16_t new_val)
{
	int err;
    if(!path) return -EINVAL;
	err = k_mutex_lock(&path->path_mutex, K_FOREVER);
	if (err)
		return err;
	path->cost = new_val;
	err = k_mutex_unlock(&path->path_mutex);
	if (err)
		return err;
	return 0;
}

int path_t_cost_get(struct path_t *path, uint16_t * ret_val)
{
	int err;
    if(!path || !ret_val) return -EINVAL;
	err = k_mutex_lock(&path->path_mutex, K_FOREVER);
	if (err)
		return err;
	*ret_val = path->cost;
	err = k_mutex_unlock(&path->path_mutex);
	if (err)
		return err;
	return 0;
}

int graph_set_cost_uni_direction(struct node_t *node1, struct node_t *node2, uint8_t new_cost)
{
    int err;
	for (uint8_t i = 0; i < node1->paths_size; i++) {
		if ((node1->paths + i)->node_ptr == node2) {
			err = path_t_cost_set(node1->paths + i, new_cost);
            if(err) return err;
            return 0;
		}
	}
    return EINVAL;
}


int node_to_byte_array(struct node_t *node, uint8_t buffer[],
			uint8_t buffer_size)
{
	// First two fields in buffer are always the same and identify the node 
	// with relation to which the rest of connections is made
    if(!node || !buffer) return -EINVAL;

	buffer[0] = node->addr;
	buffer[1] = node->paths_size;

	// Rest of fields represent the connections of that node
	for (uint8_t i = 0; i < node->paths_size; i++) {
		uint8_t neighbor_addr_idx = 2 * i + 2 + 0;
		uint8_t neighbor_dist_idx = 2 * i + 2 + 1;
        
        if(neighbor_dist_idx > node->paths_size - 1 || neighbor_dist_idx > node->paths_size - 1) {
            return -EINVAL;
        }

		uint16_t cost;
		path_t_cost_get(node->paths + i, &cost);
		buffer[neighbor_addr_idx] = (node->paths + i)->node_ptr->addr;
		buffer[neighbor_dist_idx] = cost;
	}
    return 0;
}


int load_rtr(struct node_t graph[], uint8_t buff[], uint8_t size)
{
    if(!graph || !buff) return -EINVAL;
	// First two bytes of each rtr are self addr and n neighs
	uint8_t node_addr = buff[0];
	uint8_t neighs_n = buff[1];
    
	// Then iterate over node neighs 
	for (uint8_t j = 0; j < neighs_n; j++) {
		uint8_t idx = 1 + 1 + (2 * j);
		if (idx > size) {
			return EINVAL;
		}
		uint8_t neigh_addr = buff[idx];
		uint8_t cost_to_neigh = buff[idx + 1];
        int err = graph_set_cost_uni_direction(&graph[node_addr], &graph[neigh_addr], cost_to_neigh);
        if(err) return err;
	}
    return 0;
}

void print_graph(struct node_t graph[])
{
    __ASSERT(graph != NULL, "ERROR: Graph is NULL\n");
	printk("Mesh topology:\n");
	uint16_t cost;
	for (uint8_t i = 0; i < MAX_MESH_SIZE; i++) {
		printk("Node %d\n", graph[i].addr);
		printk("Connected to: \n");
		for (uint8_t j = 0; j < graph[i].paths_size; j++) {
			path_t_cost_get(graph[i].paths + j, &cost);
			printk("----Node %d with distance: %d \n",
			       graph[i].paths[j].node_ptr->addr, cost);
		}
	}
}

int identify_self_in_graph(struct node_t *graph, char identity_str[], uint8_t len)
{
    if(!graph || !identity_str) return -EINVAL;
	// get all configured identities 
	bt_addr_le_t identities[CONFIG_BT_ID_MAX];
	size_t count = 0;
    
	bt_id_get(NULL, &count);	
	bt_id_get(identities, &count);
    if(count == 0) return -EINVAL;

	bt_addr_le_to_str(&identities[0], identity_str, len);

	int err = get_ptr_to_node_by_ble_addr(graph, identity_str, &common_self_ptr);
    if(err) return err;
    return 0;
}


int get_ptr_to_node_by_ble_addr(struct node_t *graph,
				char *ble_addr, struct node_t **ptr)
{
    if(!graph || !ble_addr || !ptr) return -EINVAL;
	for (uint8_t i = 0; i < MAX_MESH_SIZE; i++) {
		if (!memcmp(graph[i].addr_bt_le, ble_addr, 17)) {
			*ptr = (graph + i);
			return 0;
		}
	}
	return -EINVAL;
}
```
